## CMakeLists.txt
```
cmake_minimum_required(VERSION 3.20.0)

find_package(Zephyr REQUIRED HINTS $ENV{ZEPHYR_BASE})
project(gatt_gen_minimal)

target_sources(app PRIVATE src/main.c)
target_sources(app PRIVATE src/minimal_svc_service.c)
```

## sample.yaml
```
sample:
  name: GATT Generated gatt_gen_minimal

tests:
  sample.bluetooth.ble_gatt_generator_gatt_gen_minimal:
    build_only: true
    platform_allow:
      - native_sim
      - nrf52_bsim/native
    tags: bluetooth
```

## prj.conf
```kconfig
# Minimal Kconfig for the gatt_gen_minimal profile.
# See KCONFIG_NOTES.md for why each symbol is required.
CONFIG_BT=y
CONFIG_BT_DEVICE_NAME="GATT Gen gatt_gen_minimal"
CONFIG_BT_PERIPHERAL=y
CONFIG_LOG=y
CONFIG_BT_DEVICE_APPEARANCE=0
```

## src/main.c
```c
/*
 * Copyright (c) 2026 Ankit Modi
 *
 * SPDX-License-Identifier: Apache-2.0
 */

/** @file
 *  @brief Sample application for the generated gatt_gen_minimal GATT profile.
 *
 *  Generated once by ble-gatt-generator. This file is yours to edit; it is
 *  not overwritten on regeneration unless --force is given.
 */

#include <zephyr/bluetooth/bluetooth.h>
#include <zephyr/bluetooth/conn.h>
#include <zephyr/bluetooth/gatt.h>
#include <zephyr/bluetooth/uuid.h>
#include <zephyr/kernel.h>
#include <zephyr/sys/printk.h>

#include "minimal_svc_service.h"

/* Advertise the first service UUID so scanners can filter on it. */
static const struct bt_data ad[] = {
	BT_DATA_BYTES(BT_DATA_FLAGS, (BT_LE_AD_GENERAL | BT_LE_AD_NO_BREDR)),
	BT_DATA_BYTES(BT_DATA_UUID128_ALL,
		      BT_UUID_128_ENCODE(0x12345678, 0x1234, 0x5678, 0x1234, 0x56789abcdef0)),
};

static const struct bt_data sd[] = {
	BT_DATA(BT_DATA_NAME_COMPLETE, CONFIG_BT_DEVICE_NAME, sizeof(CONFIG_BT_DEVICE_NAME) - 1),
};

int main(void)
{
	int err;

	err = bt_enable(NULL);
	if (err) {
		printk("Bluetooth init failed (err %d)\n", err);
		return 0;
	}

	printk("Bluetooth initialized\n");

	err = bt_le_adv_start(BT_LE_ADV_CONN_FAST_1, ad, ARRAY_SIZE(ad), sd, ARRAY_SIZE(sd));
	if (err) {
		printk("Advertising failed to start (err %d)\n", err);
		return 0;
	}

	printk("Advertising successfully started\n");

	while (1) {
		k_sleep(K_SECONDS(1));
	}

	return 0;
}
```

## src/minimal_svc_service.c
```c
/*
 * Copyright (c) 2026 Ankit Modi
 *
 * SPDX-License-Identifier: Apache-2.0
 */

/** @file
 *  @brief gatt_gen_minimal GATT service implementation (minimal_svc).
 *
 *  Auto-generated by ble-gatt-generator; do not edit. Put application logic in
 *  main.c or your own sources and call the public helpers declared in
 *  minimal_svc_service.h.
 */

#include <errno.h>
#include <stdint.h>
#include <string.h>

#include <zephyr/kernel.h>
#include <zephyr/sys/printk.h>
#include <zephyr/bluetooth/bluetooth.h>
#include <zephyr/bluetooth/gatt.h>
#include <zephyr/bluetooth/uuid.h>

#include "minimal_svc_service.h"

/* ------------------------------------------------------------------------- */
/* Characteristic value storage                                              */
/* ------------------------------------------------------------------------- */

static uint8_t minimal_svc_read_only_value[MINIMAL_SVC_READ_ONLY_SIZE];
static K_MUTEX_DEFINE(minimal_svc_read_only_lock);
static uint8_t minimal_svc_read_write_value[MINIMAL_SVC_READ_WRITE_SIZE];
static K_MUTEX_DEFINE(minimal_svc_read_write_lock);

/* ------------------------------------------------------------------------- */
/* Static descriptor payloads                                                */
/* ------------------------------------------------------------------------- */

/* ------------------------------------------------------------------------- */
/* Thread-safe accessors                                                     */
/* ------------------------------------------------------------------------- */

int minimal_svc_read_only_set(const uint8_t *data, uint16_t len)
{
	if (data == NULL || len > sizeof(minimal_svc_read_only_value)) {
		return -EINVAL;
	}

	k_mutex_lock(&minimal_svc_read_only_lock, K_FOREVER);
	memcpy(minimal_svc_read_only_value, data, len);
	k_mutex_unlock(&minimal_svc_read_only_lock);

	return 0;
}

int minimal_svc_read_only_get(uint8_t *data, uint16_t len)
{
	if (data == NULL) {
		return -EINVAL;
	}
	if (len > sizeof(minimal_svc_read_only_value)) {
		return -EINVAL;
	}

	k_mutex_lock(&minimal_svc_read_only_lock, K_FOREVER);
	memcpy(data, minimal_svc_read_only_value, MIN(len, sizeof(minimal_svc_read_only_value)));
	k_mutex_unlock(&minimal_svc_read_only_lock);

	return 0;
}

int minimal_svc_read_write_set(const uint8_t *data, uint16_t len)
{
	if (data == NULL || len > sizeof(minimal_svc_read_write_value)) {
		return -EINVAL;
	}

	k_mutex_lock(&minimal_svc_read_write_lock, K_FOREVER);
	memcpy(minimal_svc_read_write_value, data, len);
	k_mutex_unlock(&minimal_svc_read_write_lock);

	return 0;
}

int minimal_svc_read_write_get(uint8_t *data, uint16_t len)
{
	if (data == NULL) {
		return -EINVAL;
	}
	if (len > sizeof(minimal_svc_read_write_value)) {
		return -EINVAL;
	}

	k_mutex_lock(&minimal_svc_read_write_lock, K_FOREVER);
	memcpy(data, minimal_svc_read_write_value, MIN(len, sizeof(minimal_svc_read_write_value)));
	k_mutex_unlock(&minimal_svc_read_write_lock);

	return 0;
}

/* ------------------------------------------------------------------------- */
/* GATT attribute callbacks                                                  */
/* ------------------------------------------------------------------------- */

static ssize_t minimal_svc_read_only_read(struct bt_conn *conn, const struct bt_gatt_attr *attr,
					  void *buf, uint16_t len, uint16_t offset)
{
	ssize_t ret;

	minimal_svc_read_only_on_read();

	k_mutex_lock(&minimal_svc_read_only_lock, K_FOREVER);
	ret = bt_gatt_attr_read(conn, attr, buf, len, offset, minimal_svc_read_only_value,
				sizeof(minimal_svc_read_only_value));
	k_mutex_unlock(&minimal_svc_read_only_lock);

	return ret;
}

static ssize_t minimal_svc_read_write_read(struct bt_conn *conn, const struct bt_gatt_attr *attr,
					   void *buf, uint16_t len, uint16_t offset)
{
	ssize_t ret;

	minimal_svc_read_write_on_read();

	k_mutex_lock(&minimal_svc_read_write_lock, K_FOREVER);
	ret = bt_gatt_attr_read(conn, attr, buf, len, offset, minimal_svc_read_write_value,
				sizeof(minimal_svc_read_write_value));
	k_mutex_unlock(&minimal_svc_read_write_lock);

	return ret;
}

static ssize_t minimal_svc_read_write_write(struct bt_conn *conn, const struct bt_gatt_attr *attr,
					    const void *buf, uint16_t len, uint16_t offset,
					    uint8_t flags)
{
	ARG_UNUSED(conn);
	ARG_UNUSED(attr);

	if (offset + len > sizeof(minimal_svc_read_write_value)) {
		return BT_GATT_ERR(BT_ATT_ERR_INVALID_OFFSET);
	}

	/* Prepare writes only validate; the value is committed on execute. */
	if (flags & BT_GATT_WRITE_FLAG_PREPARE) {
		return 0;
	}

	k_mutex_lock(&minimal_svc_read_write_lock, K_FOREVER);
	memcpy(minimal_svc_read_write_value + offset, buf, len);
	k_mutex_unlock(&minimal_svc_read_write_lock);

	minimal_svc_read_write_on_write(minimal_svc_read_write_value,
					sizeof(minimal_svc_read_write_value));

	return len;
}

/* ------------------------------------------------------------------------- */
/* Application hooks (weak defaults; override in your own sources)           */
/* ------------------------------------------------------------------------- */

__weak void minimal_svc_read_only_on_read(void)
{
}

__weak void minimal_svc_read_write_on_read(void)
{
}
__weak void minimal_svc_read_write_on_write(const uint8_t *data, uint16_t len)
{
	ARG_UNUSED(data);
	ARG_UNUSED(len);
}

/* ------------------------------------------------------------------------- */
/* Push helpers                                                              */
/* ------------------------------------------------------------------------- */

/* ------------------------------------------------------------------------- */
/* Service declaration                                                       */
/* ------------------------------------------------------------------------- */

/* clang-format off */
BT_GATT_SERVICE_DEFINE(minimal_svc,
	BT_GATT_PRIMARY_SERVICE(MINIMAL_SVC_UUID),

	/* read_only: read */
	BT_GATT_CHARACTERISTIC(MINIMAL_SVC_READ_ONLY_UUID,
			       BT_GATT_CHRC_READ,
			       BT_GATT_PERM_READ,
			       minimal_svc_read_only_read,
			       NULL,
			       minimal_svc_read_only_value),

	/* read_write: read, write */
	BT_GATT_CHARACTERISTIC(MINIMAL_SVC_READ_WRITE_UUID,
			       BT_GATT_CHRC_READ | BT_GATT_CHRC_WRITE,
			       BT_GATT_PERM_READ | BT_GATT_PERM_WRITE,
			       minimal_svc_read_write_read,
			       minimal_svc_read_write_write,
			       minimal_svc_read_write_value),
);
/* clang-format on */
```

## src/minimal_svc_service.h
```c
/*
 * Copyright (c) 2026 Ankit Modi
 *
 * SPDX-License-Identifier: Apache-2.0
 */

/** @file
 *  @brief gatt_gen_minimal GATT service public API (minimal_svc).
 *
 *  Auto-generated by ble-gatt-generator; do not edit.
 */

#ifndef BLE_GATT_GENERATOR_MINIMAL_SVC_H_
#define BLE_GATT_GENERATOR_MINIMAL_SVC_H_

#include <stdbool.h>
#include <stdint.h>

#include <zephyr/bluetooth/uuid.h>

#ifdef __cplusplus
extern "C" {
#endif

/** @defgroup minimal_svc minimal_svc service
 *  @brief Generated helpers for the minimal_svc GATT service.
 *  @{
 */

/* Service and characteristic UUIDs. */
#define MINIMAL_SVC_UUID                                                                           \
	BT_UUID_DECLARE_128(BT_UUID_128_ENCODE(0x12345678, 0x1234, 0x5678, 0x1234, 0x56789abcdef0))
#define MINIMAL_SVC_READ_ONLY_UUID                                                                 \
	BT_UUID_DECLARE_128(BT_UUID_128_ENCODE(0x12345678, 0x1234, 0x5678, 0x1234, 0x56789abcdef1))
#define MINIMAL_SVC_READ_WRITE_UUID                                                                \
	BT_UUID_DECLARE_128(BT_UUID_128_ENCODE(0x12345678, 0x1234, 0x5678, 0x1234, 0x56789abcdef2))

/* Characteristic value sizes in bytes. */
#define MINIMAL_SVC_READ_ONLY_SIZE  1
#define MINIMAL_SVC_READ_WRITE_SIZE 20

/** @brief Set the read_only characteristic value.
 *
 *  Thread-safe when @c thread_safe is enabled for this characteristic.
 *
 *  @param data Pointer to the data to copy into the value buffer.
 *  @param len  Number of bytes to copy; must not exceed
 *              MINIMAL_SVC_READ_ONLY_SIZE.
 *
 *  @retval 0 on success.
 *  @retval -EINVAL if @p data is NULL or @p len is too large.
 */
int minimal_svc_read_only_set(const uint8_t *data, uint16_t len);

/** @brief Get the read_only characteristic value.
 *
 *  @param data Buffer to receive the value.
 *  @param len  Number of bytes to copy; must not exceed
 *              MINIMAL_SVC_READ_ONLY_SIZE.
 *
 *  @retval 0 on success.
 *  @retval -EINVAL if @p data is NULL or @p len is too large.
 */
int minimal_svc_read_only_get(uint8_t *data, uint16_t len);

/** @brief Application hook called before a peer reads read_only.
 *
 *  Defined as a weak no-op in the generated source. Define it in your own
 *  code to refresh the value or gate the read; it runs from the Bluetooth
 *  RX context, so keep it short.
 */
void minimal_svc_read_only_on_read(void);

/** @brief Set the read_write characteristic value.
 *
 *  Thread-safe when @c thread_safe is enabled for this characteristic.
 *
 *  @param data Pointer to the data to copy into the value buffer.
 *  @param len  Number of bytes to copy; must not exceed
 *              MINIMAL_SVC_READ_WRITE_SIZE.
 *
 *  @retval 0 on success.
 *  @retval -EINVAL if @p data is NULL or @p len is too large.
 */
int minimal_svc_read_write_set(const uint8_t *data, uint16_t len);

/** @brief Get the read_write characteristic value.
 *
 *  @param data Buffer to receive the value.
 *  @param len  Number of bytes to copy; must not exceed
 *              MINIMAL_SVC_READ_WRITE_SIZE.
 *
 *  @retval 0 on success.
 *  @retval -EINVAL if @p data is NULL or @p len is too large.
 */
int minimal_svc_read_write_get(uint8_t *data, uint16_t len);

/** @brief Application hook called before a peer reads read_write.
 *
 *  Defined as a weak no-op in the generated source. Define it in your own
 *  code to refresh the value or gate the read; it runs from the Bluetooth
 *  RX context, so keep it short.
 */
void minimal_svc_read_write_on_read(void);

/** @brief Application hook called after a peer writes read_write.
 *
 *  Defined as a weak no-op in the generated source. Define this function in
 *  your own code to react to remote writes; it is called outside the value
 *  lock from the Bluetooth RX context, so keep it short.
 *
 *  @param data Pointer to the (already updated) value buffer.
 *  @param len  Size of the value buffer in bytes.
 */
void minimal_svc_read_write_on_write(const uint8_t *data, uint16_t len);

/** @} */

#ifdef __cplusplus
}
#endif

#endif /* BLE_GATT_GENERATOR_MINIMAL_SVC_H_ */
```
