## CMakeLists.txt
```
# SPDX-License-Identifier: Apache-2.0

# BabbleSim self-test for the generated gatt_gen_full GATT profile.
# Build for nrf52_bsim and run with ./run_test.sh (requires a compiled
# BabbleSim at ${ZEPHYR_BASE}/../tools/bsim or $BSIM_OUT_PATH).

cmake_minimum_required(VERSION 3.20.0)

find_package(Zephyr REQUIRED HINTS $ENV{ZEPHYR_BASE})
project(bsim_test_gatt_gen_full)

add_subdirectory(${ZEPHYR_BASE}/tests/bsim/babblekit babblekit)
target_link_libraries(app PRIVATE babblekit)

FILE(GLOB app_sources src/*.c)
target_sources(app PRIVATE ${app_sources})

# The generated GATT services under test live in the parent sample.
target_sources(app PRIVATE ${CMAKE_CURRENT_SOURCE_DIR}/../src/props_svc_service.c)
target_sources(app PRIVATE ${CMAKE_CURRENT_SOURCE_DIR}/../src/sec_svc_service.c)
target_sources(app PRIVATE ${CMAKE_CURRENT_SOURCE_DIR}/../src/desc_svc_service.c)
target_include_directories(app PRIVATE ${CMAKE_CURRENT_SOURCE_DIR}/../src)

zephyr_include_directories(
  ${BSIM_COMPONENTS_PATH}/libUtilv1/src/
  ${BSIM_COMPONENTS_PATH}/libPhyComv1/src/
  )
```

## prj.conf
```kconfig
# BabbleSim self-test: one binary plays both the peripheral running the
# generated GATT services and the central that verifies them.
CONFIG_BT=y
CONFIG_BT_PERIPHERAL=y
CONFIG_BT_CENTRAL=y
CONFIG_BT_OBSERVER=y
CONFIG_BT_GATT_CLIENT=y
CONFIG_BT_GATT_AUTO_DISCOVER_CCC=y
CONFIG_BT_DEVICE_NAME="GATT Gen gatt_gen_full"
# Some characteristics require encryption/authentication.
CONFIG_BT_SMP=y
# Authenticated/LESC permissions need MITM pairing; a fixed passkey makes
# the pairing deterministic inside the simulation.
CONFIG_BT_FIXED_PASSKEY=y
CONFIG_BT_SMP_SC_ONLY=y
CONFIG_ASSERT=y
CONFIG_LOG=y
```

## src/main.c
```c
/*
 * Copyright (c) 2026 Ankit Modi
 *
 * SPDX-License-Identifier: Apache-2.0
 */

/** @file
 *  @brief BabbleSim test entry point for the generated gatt_gen_full profile.
 *
 *  Auto-generated by ble-gatt-generator; do not edit.
 */

#include "bstests.h"

extern struct bst_test_list *test_peripheral_install(struct bst_test_list *tests);
extern struct bst_test_list *test_central_install(struct bst_test_list *tests);

bst_test_install_t test_installers[] = {test_peripheral_install, test_central_install, NULL};

int main(void)
{
	bst_main();
	return 0;
}
```

## src/peripheral.c
```c
/*
 * Copyright (c) 2026 Ankit Modi
 *
 * SPDX-License-Identifier: Apache-2.0
 */

/** @file
 *  @brief BabbleSim peripheral role for the gatt_gen_full self-test.
 *
 *  Runs the generated GATT services, advertises, and pushes notification /
 *  indication values once the central device reports it is subscribed.
 *
 *  Auto-generated by ble-gatt-generator; do not edit.
 */

#include <stddef.h>
#include <errno.h>
#include <string.h>

#include <zephyr/kernel.h>
#include <zephyr/types.h>
#include <zephyr/bluetooth/bluetooth.h>
#include <zephyr/bluetooth/conn.h>
#include <zephyr/bluetooth/uuid.h>
#include <zephyr/bluetooth/gatt.h>

#include "babblekit/testcase.h"
#include "babblekit/flags.h"
#include "babblekit/sync.h"

#include "props_svc_service.h"
#include "sec_svc_service.h"
#include "desc_svc_service.h"

/* Notifications pushed per characteristic once the central subscribes. */
#define NOTIFICATION_COUNT 5
/* Fixed passkey shared with the central so pairing always succeeds. */
#define TEST_PASSKEY       123456

DEFINE_FLAG_STATIC(flag_is_connected);
static struct bt_conn *g_conn;

static void connected(struct bt_conn *conn, uint8_t err)
{
	char addr[BT_ADDR_LE_STR_LEN];

	bt_addr_le_to_str(bt_conn_get_dst(conn), addr, sizeof(addr));

	if (err != 0) {
		TEST_FAIL("Failed to connect to %s (%u)", addr, err);
		return;
	}

	printk("Connected to %s\n", addr);

	g_conn = bt_conn_ref(conn);
	SET_FLAG(flag_is_connected);
}

static void disconnected(struct bt_conn *conn, uint8_t reason)
{
	char addr[BT_ADDR_LE_STR_LEN];

	if (conn != g_conn) {
		return;
	}

	bt_addr_le_to_str(bt_conn_get_dst(conn), addr, sizeof(addr));

	printk("Disconnected: %s (reason 0x%02x)\n", addr, reason);

	bt_conn_unref(g_conn);
	g_conn = NULL;
	UNSET_FLAG(flag_is_connected);
}

BT_CONN_CB_DEFINE(conn_callbacks) = {
	.connected = connected,
	.disconnected = disconnected,
};

/* Pairing callbacks mirroring the central side: every pairing method is
 * answered deterministically so the link reaches the required level.
 */
static void auth_passkey_display(struct bt_conn *conn, unsigned int passkey)
{
	ARG_UNUSED(conn);
	ARG_UNUSED(passkey);
}

static void auth_passkey_entry(struct bt_conn *conn)
{
	int err = bt_conn_auth_passkey_entry(conn, TEST_PASSKEY);

	if (err) {
		TEST_FAIL("Passkey entry failed (err %d)", err);
	}
}

static void auth_passkey_confirm(struct bt_conn *conn, unsigned int passkey)
{
	ARG_UNUSED(passkey);

	int err = bt_conn_auth_passkey_confirm(conn);

	if (err) {
		TEST_FAIL("Passkey confirm failed (err %d)", err);
	}
}

static void auth_pairing_confirm(struct bt_conn *conn)
{
	int err = bt_conn_auth_pairing_confirm(conn);

	if (err) {
		TEST_FAIL("Pairing confirm failed (err %d)", err);
	}
}

static void auth_cancel(struct bt_conn *conn)
{
	ARG_UNUSED(conn);
}

static struct bt_conn_auth_cb auth_callbacks = {
	.passkey_display = auth_passkey_display,
	.passkey_entry = auth_passkey_entry,
	.passkey_confirm = auth_passkey_confirm,
	.pairing_confirm = auth_pairing_confirm,
	.cancel = auth_cancel,
};

static const struct bt_data ad[] = {
	BT_DATA_BYTES(BT_DATA_FLAGS, (BT_LE_AD_GENERAL | BT_LE_AD_NO_BREDR)),
	BT_DATA_BYTES(BT_DATA_UUID128_ALL,
		      BT_UUID_128_ENCODE(0x12345678, 0x1234, 0x5678, 0x1234, 0x56789abcdef0)),
};

static void test_peripheral(void)
{
	int err;

	err = bk_sync_init();
	if (err) {
		TEST_FAIL("Backchannel init failed (err %d)", err);
	}

	err = bt_passkey_set(TEST_PASSKEY);
	if (err) {
		TEST_FAIL("bt_passkey_set failed (err %d)", err);
	}

	err = bt_conn_auth_cb_register(&auth_callbacks);
	if (err) {
		TEST_FAIL("Auth callback register failed (err %d)", err);
	}

	err = bt_enable(NULL);
	if (err != 0) {
		TEST_FAIL("Bluetooth init failed (err %d)", err);
	}

	printk("Bluetooth initialized\n");

	err = bt_le_adv_start(BT_LE_ADV_CONN_FAST_1, ad, ARRAY_SIZE(ad), NULL, 0);
	if (err != 0) {
		TEST_FAIL("Advertising failed to start (err %d)", err);
	}

	printk("Advertising successfully started\n");

	WAIT_FOR_FLAG(flag_is_connected);

	/* Wait until the central has discovered and subscribed. */
	bk_sync_wait();
	printk("Peer ready, pushing values\n");

	for (int i = 0; i < NOTIFICATION_COUNT; i++) {
		uint8_t payload[PROPS_SVC_NOTIFY_ONLY_SIZE];

		(void)memset(payload, i, sizeof(payload));
		err = props_svc_notify_only_notify(payload, sizeof(payload));
		if (err) {
			TEST_FAIL("notify_only notify failed (err %d)", err);
		}
	}
	{
		uint8_t payload[PROPS_SVC_INDICATE_ONLY_SIZE];

		(void)memset(payload, 0x5a, sizeof(payload));
		err = props_svc_indicate_only_indicate(payload, sizeof(payload));
		if (err) {
			TEST_FAIL("indicate_only indicate failed (err %d)", err);
		}
		/* Let the confirmation arrive before proceeding. */
		k_sleep(K_MSEC(100));
	}
	for (int i = 0; i < NOTIFICATION_COUNT; i++) {
		uint8_t payload[PROPS_SVC_READ_NOTIFY_SIZE];

		(void)memset(payload, i, sizeof(payload));
		err = props_svc_read_notify_notify(payload, sizeof(payload));
		if (err) {
			TEST_FAIL("read_notify notify failed (err %d)", err);
		}
	}
	{
		uint8_t payload[PROPS_SVC_READ_INDICATE_SIZE];

		(void)memset(payload, 0x5a, sizeof(payload));
		err = props_svc_read_indicate_indicate(payload, sizeof(payload));
		if (err) {
			TEST_FAIL("read_indicate indicate failed (err %d)", err);
		}
		/* Let the confirmation arrive before proceeding. */
		k_sleep(K_MSEC(100));
	}
	for (int i = 0; i < NOTIFICATION_COUNT; i++) {
		uint8_t payload[PROPS_SVC_RW_NOTIFY_SIZE];

		(void)memset(payload, i, sizeof(payload));
		err = props_svc_rw_notify_notify(payload, sizeof(payload));
		if (err) {
			TEST_FAIL("rw_notify notify failed (err %d)", err);
		}
	}
	{
		uint8_t payload[PROPS_SVC_RW_INDICATE_SIZE];

		(void)memset(payload, 0x5a, sizeof(payload));
		err = props_svc_rw_indicate_indicate(payload, sizeof(payload));
		if (err) {
			TEST_FAIL("rw_indicate indicate failed (err %d)", err);
		}
		/* Let the confirmation arrive before proceeding. */
		k_sleep(K_MSEC(100));
	}
	for (int i = 0; i < NOTIFICATION_COUNT; i++) {
		uint8_t payload[PROPS_SVC_WWR_NOTIFY_SIZE];

		(void)memset(payload, i, sizeof(payload));
		err = props_svc_wwr_notify_notify(payload, sizeof(payload));
		if (err) {
			TEST_FAIL("wwr_notify notify failed (err %d)", err);
		}
	}
	for (int i = 0; i < NOTIFICATION_COUNT; i++) {
		uint8_t payload[SEC_SVC_ENC_NOTIFY_SIZE];

		(void)memset(payload, i, sizeof(payload));
		err = sec_svc_enc_notify_notify(payload, sizeof(payload));
		if (err) {
			TEST_FAIL("enc_notify notify failed (err %d)", err);
		}
	}
	{
		uint8_t payload[SEC_SVC_AUTH_INDICATE_SIZE];

		(void)memset(payload, 0x5a, sizeof(payload));
		err = sec_svc_auth_indicate_indicate(payload, sizeof(payload));
		if (err) {
			TEST_FAIL("auth_indicate indicate failed (err %d)", err);
		}
		/* Let the confirmation arrive before proceeding. */
		k_sleep(K_MSEC(100));
	}
	for (int i = 0; i < NOTIFICATION_COUNT; i++) {
		uint8_t payload[DESC_SVC_DESCRIBED_SIZE];

		(void)memset(payload, i, sizeof(payload));
		err = desc_svc_described_notify(payload, sizeof(payload));
		if (err) {
			TEST_FAIL("described notify failed (err %d)", err);
		}
	}

	/* Wait until the central has verified all values, then pass. */
	bk_sync_wait();

	TEST_PASS("gatt_gen_full peripheral passed");
}

static const struct bst_test_instance test_peripheral_def[] = {
	{
		.test_id = "peripheral",
		.test_main_f = test_peripheral,
	},
	BSTEST_END_MARKER,
};

struct bst_test_list *test_peripheral_install(struct bst_test_list *tests)
{
	return bst_add_tests(tests, test_peripheral_def);
}
```
