## samples/gatt_gen_kitchen_sink/bsim/testcase.yaml
```yaml
tests:
  bluetooth.gatt_gen_gatt_gen_full.selftest:
    build_only: true
    tags:
      - bluetooth
    platform_allow:
      - nrf52_bsim/native
    harness: bsim
    harness_config:
      bsim_exe_name: gatt_gen_gatt_gen_full_selftest
```

## samples/gatt_gen_notify/bsim/testcase.yaml
```yaml
tests:
  bluetooth.gatt_gen_gatt_gen_notify.selftest:
    build_only: true
    tags:
      - bluetooth
    platform_allow:
      - nrf52_bsim/native
    harness: bsim
    harness_config:
      bsim_exe_name: gatt_gen_gatt_gen_notify_selftest
```
