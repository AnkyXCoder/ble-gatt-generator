## CMakeLists.txt
```
cmake_minimum_required(VERSION 3.20.0)

find_package(Zephyr REQUIRED HINTS $ENV{ZEPHYR_BASE})
project(gatt_gen_full)

target_sources(app PRIVATE src/main.c)
target_sources(app PRIVATE src/props_svc_service.c)
target_sources(app PRIVATE src/sec_svc_service.c)
target_sources(app PRIVATE src/desc_svc_service.c)
```

## sample.yaml
```
sample:
  name: GATT Generated gatt_gen_full

tests:
  sample.bluetooth.ble_gatt_generator_gatt_gen_full:
    build_only: true
    platform_allow:
      - native_sim
      - nrf52_bsim/native
    tags: bluetooth
```

## prj.conf
```kconfig
# Minimal Kconfig for the gatt_gen_full profile.
# See KCONFIG_NOTES.md for why each symbol is required.
CONFIG_BT=y
CONFIG_BT_DEVICE_NAME="GATT Gen gatt_gen_full"
CONFIG_BT_PERIPHERAL=y
CONFIG_BT_SMP=y
# (advisory) CONFIG_BT_FIXED_PASSKEY=y — Used by the generated BabbleSim test only — do NOT enable in production; a real device needs MITM-capable IO (display/keyboard) or OOB instead
# (advisory) CONFIG_BT_SMP_SC_ONLY=y — read_lesc/write_lesc permissions need LE Secure Connections pairing
# (advisory) CONFIG_BT_SIGNING=y — authenticated_signed_writes needs signing support; the app must also provision signing keys / bonded peer
CONFIG_BT_ATT_PREPARE_COUNT=2
CONFIG_BT_L2CAP_TX_MTU=68
# (advisory) CONFIG_BT_BUF_ACL_TX_SIZE=72 — ACL TX buffer must fit the L2CAP SDU + header
# (advisory) CONFIG_BT_BUF_ACL_RX_SIZE=72 — ACL RX buffer must fit the L2CAP SDU + header
# (advisory) CONFIG_BT_GATT_NOTIFY_MULTIPLE=y — Optional: batch notifications when several CCCs are enabled at once
CONFIG_LOG=y
CONFIG_BT_DEVICE_APPEARANCE=0
```

## src/main.c
```c
/*
 * Copyright (c) 2026 Ankit Modi
 *
 * SPDX-License-Identifier: Apache-2.0
 */

/** @file
 *  @brief Sample application for the generated gatt_gen_full GATT profile.
 *
 *  Generated once by ble-gatt-generator. This file is yours to edit; it is
 *  not overwritten on regeneration unless --force is given.
 */

#include <zephyr/bluetooth/bluetooth.h>
#include <zephyr/bluetooth/conn.h>
#include <zephyr/bluetooth/gatt.h>
#include <zephyr/bluetooth/uuid.h>
#include <zephyr/kernel.h>
#include <zephyr/sys/printk.h>

#include "props_svc_service.h"
#include "sec_svc_service.h"
#include "desc_svc_service.h"

/* Advertise the first service UUID so scanners can filter on it. */
static const struct bt_data ad[] = {
	BT_DATA_BYTES(BT_DATA_FLAGS, (BT_LE_AD_GENERAL | BT_LE_AD_NO_BREDR)),
	BT_DATA_BYTES(BT_DATA_UUID128_ALL,
		      BT_UUID_128_ENCODE(0x12345678, 0x1234, 0x5678, 0x1234, 0x56789abcdef0)),
};

static const struct bt_data sd[] = {
	BT_DATA(BT_DATA_NAME_COMPLETE, CONFIG_BT_DEVICE_NAME, sizeof(CONFIG_BT_DEVICE_NAME) - 1),
};

int main(void)
{
	int err;

	err = bt_enable(NULL);
	if (err) {
		printk("Bluetooth init failed (err %d)\n", err);
		return 0;
	}

	printk("Bluetooth initialized\n");

	err = bt_le_adv_start(BT_LE_ADV_CONN_FAST_1, ad, ARRAY_SIZE(ad), sd, ARRAY_SIZE(sd));
	if (err) {
		printk("Advertising failed to start (err %d)\n", err);
		return 0;
	}

	printk("Advertising successfully started\n");

	while (1) {
		k_sleep(K_SECONDS(1));
	}

	return 0;
}
```

## src/desc_svc_service.c
```c
/*
 * Copyright (c) 2026 Ankit Modi
 *
 * SPDX-License-Identifier: Apache-2.0
 */

/** @file
 *  @brief gatt_gen_full GATT service implementation (desc_svc).
 *
 *  Auto-generated by ble-gatt-generator; do not edit. Put application logic in
 *  main.c or your own sources and call the public helpers declared in
 *  desc_svc_service.h.
 */

#include <errno.h>
#include <stdint.h>
#include <string.h>

#include <zephyr/kernel.h>
#include <zephyr/sys/printk.h>
#include <zephyr/bluetooth/bluetooth.h>
#include <zephyr/bluetooth/gatt.h>
#include <zephyr/bluetooth/uuid.h>

#include "desc_svc_service.h"

/* ------------------------------------------------------------------------- */
/* Characteristic value storage                                              */
/* ------------------------------------------------------------------------- */

static uint8_t desc_svc_described_value[DESC_SVC_DESCRIBED_SIZE];
static K_MUTEX_DEFINE(desc_svc_described_lock);
static uint8_t desc_svc_full_meta_value[DESC_SVC_FULL_META_SIZE];
static K_MUTEX_DEFINE(desc_svc_full_meta_lock);
static uint8_t desc_svc_plain_value[DESC_SVC_PLAIN_SIZE];
static K_MUTEX_DEFINE(desc_svc_plain_lock);

/* ------------------------------------------------------------------------- */
/* Static descriptor payloads                                                */
/* ------------------------------------------------------------------------- */

static const struct bt_gatt_cpf desc_svc_described_cpf = {
	.format = 4,
	.exponent = 0,
	.unit = 10157,
	.name_space = 1,
	.description = 0,
};
static const struct bt_gatt_cpf desc_svc_full_meta_cpf = {
	.format = 8,
	.exponent = 0,
	.unit = 0,
	.name_space = 1,
	.description = 0,
};
static const struct bt_gatt_cep desc_svc_full_meta_cep = {
	.properties = BT_GATT_CEP_RELIABLE_WRITE,
};

/* ------------------------------------------------------------------------- */
/* Thread-safe accessors                                                     */
/* ------------------------------------------------------------------------- */

int desc_svc_described_set(const uint8_t *data, uint16_t len)
{
	if (data == NULL || len > sizeof(desc_svc_described_value)) {
		return -EINVAL;
	}

	k_mutex_lock(&desc_svc_described_lock, K_FOREVER);
	memcpy(desc_svc_described_value, data, len);
	k_mutex_unlock(&desc_svc_described_lock);

	return 0;
}

int desc_svc_described_get(uint8_t *data, uint16_t len)
{
	if (data == NULL) {
		return -EINVAL;
	}
	if (len > sizeof(desc_svc_described_value)) {
		return -EINVAL;
	}

	k_mutex_lock(&desc_svc_described_lock, K_FOREVER);
	memcpy(data, desc_svc_described_value, MIN(len, sizeof(desc_svc_described_value)));
	k_mutex_unlock(&desc_svc_described_lock);

	return 0;
}

int desc_svc_full_meta_set(const uint8_t *data, uint16_t len)
{
	if (data == NULL || len > sizeof(desc_svc_full_meta_value)) {
		return -EINVAL;
	}

	k_mutex_lock(&desc_svc_full_meta_lock, K_FOREVER);
	memcpy(desc_svc_full_meta_value, data, len);
	k_mutex_unlock(&desc_svc_full_meta_lock);

	return 0;
}

int desc_svc_full_meta_get(uint8_t *data, uint16_t len)
{
	if (data == NULL) {
		return -EINVAL;
	}
	if (len > sizeof(desc_svc_full_meta_value)) {
		return -EINVAL;
	}

	k_mutex_lock(&desc_svc_full_meta_lock, K_FOREVER);
	memcpy(data, desc_svc_full_meta_value, MIN(len, sizeof(desc_svc_full_meta_value)));
	k_mutex_unlock(&desc_svc_full_meta_lock);

	return 0;
}

int desc_svc_plain_set(const uint8_t *data, uint16_t len)
{
	if (data == NULL || len > sizeof(desc_svc_plain_value)) {
		return -EINVAL;
	}

	k_mutex_lock(&desc_svc_plain_lock, K_FOREVER);
	memcpy(desc_svc_plain_value, data, len);
	k_mutex_unlock(&desc_svc_plain_lock);

	return 0;
}

int desc_svc_plain_get(uint8_t *data, uint16_t len)
{
	if (data == NULL) {
		return -EINVAL;
	}
	if (len > sizeof(desc_svc_plain_value)) {
		return -EINVAL;
	}

	k_mutex_lock(&desc_svc_plain_lock, K_FOREVER);
	memcpy(data, desc_svc_plain_value, MIN(len, sizeof(desc_svc_plain_value)));
	k_mutex_unlock(&desc_svc_plain_lock);

	return 0;
}

/* ------------------------------------------------------------------------- */
/* GATT attribute callbacks                                                  */
/* ------------------------------------------------------------------------- */

static ssize_t desc_svc_described_read(struct bt_conn *conn, const struct bt_gatt_attr *attr,
				       void *buf, uint16_t len, uint16_t offset)
{
	ssize_t ret;

	desc_svc_described_on_read();

	k_mutex_lock(&desc_svc_described_lock, K_FOREVER);
	ret = bt_gatt_attr_read(conn, attr, buf, len, offset, desc_svc_described_value,
				sizeof(desc_svc_described_value));
	k_mutex_unlock(&desc_svc_described_lock);

	return ret;
}

static void desc_svc_described_ccc_cfg_changed(const struct bt_gatt_attr *attr, uint16_t value)
{
	bool enabled = value == BT_GATT_CCC_NOTIFY;

	ARG_UNUSED(attr);

	printk("described notifications %s\n", enabled ? "enabled" : "disabled");

	desc_svc_described_on_ccc(enabled);
}

static ssize_t desc_svc_full_meta_read(struct bt_conn *conn, const struct bt_gatt_attr *attr,
				       void *buf, uint16_t len, uint16_t offset)
{
	ssize_t ret;

	desc_svc_full_meta_on_read();

	k_mutex_lock(&desc_svc_full_meta_lock, K_FOREVER);
	ret = bt_gatt_attr_read(conn, attr, buf, len, offset, desc_svc_full_meta_value,
				sizeof(desc_svc_full_meta_value));
	k_mutex_unlock(&desc_svc_full_meta_lock);

	return ret;
}

static ssize_t desc_svc_full_meta_write(struct bt_conn *conn, const struct bt_gatt_attr *attr,
					const void *buf, uint16_t len, uint16_t offset,
					uint8_t flags)
{
	ARG_UNUSED(conn);
	ARG_UNUSED(attr);

	if (offset + len > sizeof(desc_svc_full_meta_value)) {
		return BT_GATT_ERR(BT_ATT_ERR_INVALID_OFFSET);
	}

	/* Prepare writes only validate; the value is committed on execute. */
	if (flags & BT_GATT_WRITE_FLAG_PREPARE) {
		return 0;
	}

	k_mutex_lock(&desc_svc_full_meta_lock, K_FOREVER);
	memcpy(desc_svc_full_meta_value + offset, buf, len);
	k_mutex_unlock(&desc_svc_full_meta_lock);

	desc_svc_full_meta_on_write(desc_svc_full_meta_value, sizeof(desc_svc_full_meta_value));

	return len;
}

static ssize_t desc_svc_plain_read(struct bt_conn *conn, const struct bt_gatt_attr *attr, void *buf,
				   uint16_t len, uint16_t offset)
{
	ssize_t ret;

	desc_svc_plain_on_read();

	k_mutex_lock(&desc_svc_plain_lock, K_FOREVER);
	ret = bt_gatt_attr_read(conn, attr, buf, len, offset, desc_svc_plain_value,
				sizeof(desc_svc_plain_value));
	k_mutex_unlock(&desc_svc_plain_lock);

	return ret;
}

/* ------------------------------------------------------------------------- */
/* Application hooks (weak defaults; override in your own sources)           */
/* ------------------------------------------------------------------------- */

__weak void desc_svc_described_on_read(void)
{
}
__weak void desc_svc_described_on_ccc(bool enabled)
{
	ARG_UNUSED(enabled);
}

__weak void desc_svc_full_meta_on_read(void)
{
}
__weak void desc_svc_full_meta_on_write(const uint8_t *data, uint16_t len)
{
	ARG_UNUSED(data);
	ARG_UNUSED(len);
}

__weak void desc_svc_plain_on_read(void)
{
}

/* ------------------------------------------------------------------------- */
/* Push helpers                                                              */
/* ------------------------------------------------------------------------- */

int desc_svc_described_notify(const uint8_t *data, uint16_t len)
{
	int err;

	err = desc_svc_described_set(data, len);
	if (err) {
		return err;
	}

	return bt_gatt_notify_uuid(NULL, DESC_SVC_DESCRIBED_UUID, NULL, desc_svc_described_value,
				   len);
}

/* ------------------------------------------------------------------------- */
/* Service declaration                                                       */
/* ------------------------------------------------------------------------- */

/* clang-format off */
BT_GATT_SERVICE_DEFINE(desc_svc,
	BT_GATT_PRIMARY_SERVICE(DESC_SVC_UUID),

	/* described: read, notify */
	BT_GATT_CHARACTERISTIC(DESC_SVC_DESCRIBED_UUID,
			       BT_GATT_CHRC_READ | BT_GATT_CHRC_NOTIFY,
			       BT_GATT_PERM_READ,
			       desc_svc_described_read,
			       NULL,
			       desc_svc_described_value),
	BT_GATT_CUD("Fully described value", BT_GATT_PERM_READ),
	BT_GATT_CPF(&desc_svc_described_cpf),
	BT_GATT_CCC(desc_svc_described_ccc_cfg_changed, BT_GATT_PERM_READ | BT_GATT_PERM_WRITE),

	/* full_meta: read, write, extended_properties */
	BT_GATT_CHARACTERISTIC(DESC_SVC_FULL_META_UUID,
			       BT_GATT_CHRC_READ | BT_GATT_CHRC_WRITE | BT_GATT_CHRC_EXT_PROP,
			       BT_GATT_PERM_READ | BT_GATT_PERM_WRITE | BT_GATT_PERM_PREPARE_WRITE,
			       desc_svc_full_meta_read,
			       desc_svc_full_meta_write,
			       desc_svc_full_meta_value),
	BT_GATT_CUD("All descriptors present", BT_GATT_PERM_READ),
	BT_GATT_CPF(&desc_svc_full_meta_cpf),
	BT_GATT_CEP(&desc_svc_full_meta_cep),

	/* plain: read */
	BT_GATT_CHARACTERISTIC(DESC_SVC_PLAIN_UUID,
			       BT_GATT_CHRC_READ,
			       BT_GATT_PERM_READ,
			       desc_svc_plain_read,
			       NULL,
			       desc_svc_plain_value),
);
/* clang-format on */
```

## src/desc_svc_service.h
```c
/*
 * Copyright (c) 2026 Ankit Modi
 *
 * SPDX-License-Identifier: Apache-2.0
 */

/** @file
 *  @brief gatt_gen_full GATT service public API (desc_svc).
 *
 *  Auto-generated by ble-gatt-generator; do not edit.
 */

#ifndef BLE_GATT_GENERATOR_DESC_SVC_H_
#define BLE_GATT_GENERATOR_DESC_SVC_H_

#include <stdbool.h>
#include <stdint.h>

#include <zephyr/bluetooth/uuid.h>

#ifdef __cplusplus
extern "C" {
#endif

/** @defgroup desc_svc desc_svc service
 *  @brief Generated helpers for the desc_svc GATT service.
 *  @{
 */

/* Service and characteristic UUIDs. */
#define DESC_SVC_UUID                                                                              \
	BT_UUID_DECLARE_128(BT_UUID_128_ENCODE(0x12345678, 0x1234, 0x5678, 0x1234, 0x56789abcde40))
#define DESC_SVC_DESCRIBED_UUID                                                                    \
	BT_UUID_DECLARE_128(BT_UUID_128_ENCODE(0x12345678, 0x1234, 0x5678, 0x1234, 0x56789abcde41))
#define DESC_SVC_FULL_META_UUID                                                                    \
	BT_UUID_DECLARE_128(BT_UUID_128_ENCODE(0x12345678, 0x1234, 0x5678, 0x1234, 0x56789abcde42))
#define DESC_SVC_PLAIN_UUID                                                                        \
	BT_UUID_DECLARE_128(BT_UUID_128_ENCODE(0x12345678, 0x1234, 0x5678, 0x1234, 0x56789abcde43))

/* Characteristic value sizes in bytes. */
#define DESC_SVC_DESCRIBED_SIZE 4
#define DESC_SVC_FULL_META_SIZE 16
#define DESC_SVC_PLAIN_SIZE     4

/** @brief Set the described characteristic value.
 *
 *  Thread-safe when @c thread_safe is enabled for this characteristic.
 *
 *  @param data Pointer to the data to copy into the value buffer.
 *  @param len  Number of bytes to copy; must not exceed
 *              DESC_SVC_DESCRIBED_SIZE.
 *
 *  @retval 0 on success.
 *  @retval -EINVAL if @p data is NULL or @p len is too large.
 */
int desc_svc_described_set(const uint8_t *data, uint16_t len);

/** @brief Get the described characteristic value.
 *
 *  @param data Buffer to receive the value.
 *  @param len  Number of bytes to copy; must not exceed
 *              DESC_SVC_DESCRIBED_SIZE.
 *
 *  @retval 0 on success.
 *  @retval -EINVAL if @p data is NULL or @p len is too large.
 */
int desc_svc_described_get(uint8_t *data, uint16_t len);

/** @brief Application hook called before a peer reads described.
 *
 *  Defined as a weak no-op in the generated source. Define it in your own
 *  code to refresh the value or gate the read; it runs from the Bluetooth
 *  RX context, so keep it short.
 */
void desc_svc_described_on_read(void);

/** @brief Update and notify the described characteristic.
 *
 *  @param data Pointer to the new value.
 *  @param len  Length of the data in bytes.
 *
 *  @return 0 on success, or a negative error code (see bt_gatt_notify_uuid()).
 */
int desc_svc_described_notify(const uint8_t *data, uint16_t len);

/** @brief Application hook called when described CCC state changes.
 *
 *  Defined as a weak no-op in the generated source. Define it in your own
 *  code to react to a peer enabling/disabling
 *  notifications.
 *
 *  @param enabled True when notifications were enabled.
 */
void desc_svc_described_on_ccc(bool enabled);

/** @brief Set the full_meta characteristic value.
 *
 *  Thread-safe when @c thread_safe is enabled for this characteristic.
 *
 *  @param data Pointer to the data to copy into the value buffer.
 *  @param len  Number of bytes to copy; must not exceed
 *              DESC_SVC_FULL_META_SIZE.
 *
 *  @retval 0 on success.
 *  @retval -EINVAL if @p data is NULL or @p len is too large.
 */
int desc_svc_full_meta_set(const uint8_t *data, uint16_t len);

/** @brief Get the full_meta characteristic value.
 *
 *  @param data Buffer to receive the value.
 *  @param len  Number of bytes to copy; must not exceed
 *              DESC_SVC_FULL_META_SIZE.
 *
 *  @retval 0 on success.
 *  @retval -EINVAL if @p data is NULL or @p len is too large.
 */
int desc_svc_full_meta_get(uint8_t *data, uint16_t len);

/** @brief Application hook called before a peer reads full_meta.
 *
 *  Defined as a weak no-op in the generated source. Define it in your own
 *  code to refresh the value or gate the read; it runs from the Bluetooth
 *  RX context, so keep it short.
 */
void desc_svc_full_meta_on_read(void);

/** @brief Application hook called after a peer writes full_meta.
 *
 *  Defined as a weak no-op in the generated source. Define this function in
 *  your own code to react to remote writes; it is called outside the value
 *  lock from the Bluetooth RX context, so keep it short.
 *
 *  @param data Pointer to the (already updated) value buffer.
 *  @param len  Size of the value buffer in bytes.
 */
void desc_svc_full_meta_on_write(const uint8_t *data, uint16_t len);

/** @brief Set the plain characteristic value.
 *
 *  Thread-safe when @c thread_safe is enabled for this characteristic.
 *
 *  @param data Pointer to the data to copy into the value buffer.
 *  @param len  Number of bytes to copy; must not exceed
 *              DESC_SVC_PLAIN_SIZE.
 *
 *  @retval 0 on success.
 *  @retval -EINVAL if @p data is NULL or @p len is too large.
 */
int desc_svc_plain_set(const uint8_t *data, uint16_t len);

/** @brief Get the plain characteristic value.
 *
 *  @param data Buffer to receive the value.
 *  @param len  Number of bytes to copy; must not exceed
 *              DESC_SVC_PLAIN_SIZE.
 *
 *  @retval 0 on success.
 *  @retval -EINVAL if @p data is NULL or @p len is too large.
 */
int desc_svc_plain_get(uint8_t *data, uint16_t len);

/** @brief Application hook called before a peer reads plain.
 *
 *  Defined as a weak no-op in the generated source. Define it in your own
 *  code to refresh the value or gate the read; it runs from the Bluetooth
 *  RX context, so keep it short.
 */
void desc_svc_plain_on_read(void);

/** @} */

#ifdef __cplusplus
}
#endif

#endif /* BLE_GATT_GENERATOR_DESC_SVC_H_ */
```

## src/sec_svc_service.c
```c
/*
 * Copyright (c) 2026 Ankit Modi
 *
 * SPDX-License-Identifier: Apache-2.0
 */

/** @file
 *  @brief gatt_gen_full GATT service implementation (sec_svc).
 *
 *  Auto-generated by ble-gatt-generator; do not edit. Put application logic in
 *  main.c or your own sources and call the public helpers declared in
 *  sec_svc_service.h.
 */

#include <errno.h>
#include <stdint.h>
#include <string.h>

#include <zephyr/kernel.h>
#include <zephyr/sys/printk.h>
#include <zephyr/bluetooth/bluetooth.h>
#include <zephyr/bluetooth/gatt.h>
#include <zephyr/bluetooth/uuid.h>

#include "sec_svc_service.h"

/* ------------------------------------------------------------------------- */
/* Characteristic value storage                                              */
/* ------------------------------------------------------------------------- */

static uint8_t sec_svc_enc_read_value[SEC_SVC_ENC_READ_SIZE];
static K_MUTEX_DEFINE(sec_svc_enc_read_lock);
static uint8_t sec_svc_enc_write_value[SEC_SVC_ENC_WRITE_SIZE];
static K_MUTEX_DEFINE(sec_svc_enc_write_lock);
static uint8_t sec_svc_enc_rw_value[SEC_SVC_ENC_RW_SIZE];
static K_MUTEX_DEFINE(sec_svc_enc_rw_lock);
static uint8_t sec_svc_auth_read_value[SEC_SVC_AUTH_READ_SIZE];
static K_MUTEX_DEFINE(sec_svc_auth_read_lock);
static uint8_t sec_svc_auth_rw_value[SEC_SVC_AUTH_RW_SIZE];
static K_MUTEX_DEFINE(sec_svc_auth_rw_lock);
static uint8_t sec_svc_lesc_rw_value[SEC_SVC_LESC_RW_SIZE];
static K_MUTEX_DEFINE(sec_svc_lesc_rw_lock);
static uint8_t sec_svc_enc_notify_value[SEC_SVC_ENC_NOTIFY_SIZE];
static K_MUTEX_DEFINE(sec_svc_enc_notify_lock);
static uint8_t sec_svc_auth_indicate_value[SEC_SVC_AUTH_INDICATE_SIZE];
static K_MUTEX_DEFINE(sec_svc_auth_indicate_lock);

/* ------------------------------------------------------------------------- */
/* Static descriptor payloads                                                */
/* ------------------------------------------------------------------------- */

/* ------------------------------------------------------------------------- */
/* Thread-safe accessors                                                     */
/* ------------------------------------------------------------------------- */

int sec_svc_enc_read_set(const uint8_t *data, uint16_t len)
{
	if (data == NULL || len > sizeof(sec_svc_enc_read_value)) {
		return -EINVAL;
	}

	k_mutex_lock(&sec_svc_enc_read_lock, K_FOREVER);
	memcpy(sec_svc_enc_read_value, data, len);
	k_mutex_unlock(&sec_svc_enc_read_lock);

	return 0;
}

int sec_svc_enc_read_get(uint8_t *data, uint16_t len)
{
	if (data == NULL) {
		return -EINVAL;
	}
	if (len > sizeof(sec_svc_enc_read_value)) {
		return -EINVAL;
	}

	k_mutex_lock(&sec_svc_enc_read_lock, K_FOREVER);
	memcpy(data, sec_svc_enc_read_value, MIN(len, sizeof(sec_svc_enc_read_value)));
	k_mutex_unlock(&sec_svc_enc_read_lock);

	return 0;
}

int sec_svc_enc_write_set(const uint8_t *data, uint16_t len)
{
	if (data == NULL || len > sizeof(sec_svc_enc_write_value)) {
		return -EINVAL;
	}

	k_mutex_lock(&sec_svc_enc_write_lock, K_FOREVER);
	memcpy(sec_svc_enc_write_value, data, len);
	k_mutex_unlock(&sec_svc_enc_write_lock);

	return 0;
}

int sec_svc_enc_write_get(uint8_t *data, uint16_t len)
{
	if (data == NULL) {
		return -EINVAL;
	}
	if (len > sizeof(sec_svc_enc_write_value)) {
		return -EINVAL;
	}

	k_mutex_lock(&sec_svc_enc_write_lock, K_FOREVER);
	memcpy(data, sec_svc_enc_write_value, MIN(len, sizeof(sec_svc_enc_write_value)));
	k_mutex_unlock(&sec_svc_enc_write_lock);

	return 0;
}

int sec_svc_enc_rw_set(const uint8_t *data, uint16_t len)
{
	if (data == NULL || len > sizeof(sec_svc_enc_rw_value)) {
		return -EINVAL;
	}

	k_mutex_lock(&sec_svc_enc_rw_lock, K_FOREVER);
	memcpy(sec_svc_enc_rw_value, data, len);
	k_mutex_unlock(&sec_svc_enc_rw_lock);

	return 0;
}

int sec_svc_enc_rw_get(uint8_t *data, uint16_t len)
{
	if (data == NULL) {
		return -EINVAL;
	}
	if (len > sizeof(sec_svc_enc_rw_value)) {
		return -EINVAL;
	}

	k_mutex_lock(&sec_svc_enc_rw_lock, K_FOREVER);
	memcpy(data, sec_svc_enc_rw_value, MIN(len, sizeof(sec_svc_enc_rw_value)));
	k_mutex_unlock(&sec_svc_enc_rw_lock);

	return 0;
}

int sec_svc_auth_read_set(const uint8_t *data, uint16_t len)
{
	if (data == NULL || len > sizeof(sec_svc_auth_read_value)) {
		return -EINVAL;
	}

	k_mutex_lock(&sec_svc_auth_read_lock, K_FOREVER);
	memcpy(sec_svc_auth_read_value, data, len);
	k_mutex_unlock(&sec_svc_auth_read_lock);

	return 0;
}

int sec_svc_auth_read_get(uint8_t *data, uint16_t len)
{
	if (data == NULL) {
		return -EINVAL;
	}
	if (len > sizeof(sec_svc_auth_read_value)) {
		return -EINVAL;
	}

	k_mutex_lock(&sec_svc_auth_read_lock, K_FOREVER);
	memcpy(data, sec_svc_auth_read_value, MIN(len, sizeof(sec_svc_auth_read_value)));
	k_mutex_unlock(&sec_svc_auth_read_lock);

	return 0;
}

int sec_svc_auth_rw_set(const uint8_t *data, uint16_t len)
{
	if (data == NULL || len > sizeof(sec_svc_auth_rw_value)) {
		return -EINVAL;
	}

	k_mutex_lock(&sec_svc_auth_rw_lock, K_FOREVER);
	memcpy(sec_svc_auth_rw_value, data, len);
	k_mutex_unlock(&sec_svc_auth_rw_lock);

	return 0;
}

int sec_svc_auth_rw_get(uint8_t *data, uint16_t len)
{
	if (data == NULL) {
		return -EINVAL;
	}
	if (len > sizeof(sec_svc_auth_rw_value)) {
		return -EINVAL;
	}

	k_mutex_lock(&sec_svc_auth_rw_lock, K_FOREVER);
	memcpy(data, sec_svc_auth_rw_value, MIN(len, sizeof(sec_svc_auth_rw_value)));
	k_mutex_unlock(&sec_svc_auth_rw_lock);

	return 0;
}

int sec_svc_lesc_rw_set(const uint8_t *data, uint16_t len)
{
	if (data == NULL || len > sizeof(sec_svc_lesc_rw_value)) {
		return -EINVAL;
	}

	k_mutex_lock(&sec_svc_lesc_rw_lock, K_FOREVER);
	memcpy(sec_svc_lesc_rw_value, data, len);
	k_mutex_unlock(&sec_svc_lesc_rw_lock);

	return 0;
}

int sec_svc_lesc_rw_get(uint8_t *data, uint16_t len)
{
	if (data == NULL) {
		return -EINVAL;
	}
	if (len > sizeof(sec_svc_lesc_rw_value)) {
		return -EINVAL;
	}

	k_mutex_lock(&sec_svc_lesc_rw_lock, K_FOREVER);
	memcpy(data, sec_svc_lesc_rw_value, MIN(len, sizeof(sec_svc_lesc_rw_value)));
	k_mutex_unlock(&sec_svc_lesc_rw_lock);

	return 0;
}

int sec_svc_enc_notify_set(const uint8_t *data, uint16_t len)
{
	if (data == NULL || len > sizeof(sec_svc_enc_notify_value)) {
		return -EINVAL;
	}

	k_mutex_lock(&sec_svc_enc_notify_lock, K_FOREVER);
	memcpy(sec_svc_enc_notify_value, data, len);
	k_mutex_unlock(&sec_svc_enc_notify_lock);

	return 0;
}

int sec_svc_enc_notify_get(uint8_t *data, uint16_t len)
{
	if (data == NULL) {
		return -EINVAL;
	}
	if (len > sizeof(sec_svc_enc_notify_value)) {
		return -EINVAL;
	}

	k_mutex_lock(&sec_svc_enc_notify_lock, K_FOREVER);
	memcpy(data, sec_svc_enc_notify_value, MIN(len, sizeof(sec_svc_enc_notify_value)));
	k_mutex_unlock(&sec_svc_enc_notify_lock);

	return 0;
}

int sec_svc_auth_indicate_set(const uint8_t *data, uint16_t len)
{
	if (data == NULL || len > sizeof(sec_svc_auth_indicate_value)) {
		return -EINVAL;
	}

	k_mutex_lock(&sec_svc_auth_indicate_lock, K_FOREVER);
	memcpy(sec_svc_auth_indicate_value, data, len);
	k_mutex_unlock(&sec_svc_auth_indicate_lock);

	return 0;
}

int sec_svc_auth_indicate_get(uint8_t *data, uint16_t len)
{
	if (data == NULL) {
		return -EINVAL;
	}
	if (len > sizeof(sec_svc_auth_indicate_value)) {
		return -EINVAL;
	}

	k_mutex_lock(&sec_svc_auth_indicate_lock, K_FOREVER);
	memcpy(data, sec_svc_auth_indicate_value, MIN(len, sizeof(sec_svc_auth_indicate_value)));
	k_mutex_unlock(&sec_svc_auth_indicate_lock);

	return 0;
}

/* ------------------------------------------------------------------------- */
/* GATT attribute callbacks                                                  */
/* ------------------------------------------------------------------------- */

static ssize_t sec_svc_enc_read_read(struct bt_conn *conn, const struct bt_gatt_attr *attr,
				     void *buf, uint16_t len, uint16_t offset)
{
	ssize_t ret;

	sec_svc_enc_read_on_read();

	k_mutex_lock(&sec_svc_enc_read_lock, K_FOREVER);
	ret = bt_gatt_attr_read(conn, attr, buf, len, offset, sec_svc_enc_read_value,
				sizeof(sec_svc_enc_read_value));
	k_mutex_unlock(&sec_svc_enc_read_lock);

	return ret;
}

static ssize_t sec_svc_enc_write_write(struct bt_conn *conn, const struct bt_gatt_attr *attr,
				       const void *buf, uint16_t len, uint16_t offset,
				       uint8_t flags)
{
	ARG_UNUSED(conn);
	ARG_UNUSED(attr);

	if (offset + len > sizeof(sec_svc_enc_write_value)) {
		return BT_GATT_ERR(BT_ATT_ERR_INVALID_OFFSET);
	}

	/* Prepare writes only validate; the value is committed on execute. */
	if (flags & BT_GATT_WRITE_FLAG_PREPARE) {
		return 0;
	}

	k_mutex_lock(&sec_svc_enc_write_lock, K_FOREVER);
	memcpy(sec_svc_enc_write_value + offset, buf, len);
	k_mutex_unlock(&sec_svc_enc_write_lock);

	sec_svc_enc_write_on_write(sec_svc_enc_write_value, sizeof(sec_svc_enc_write_value));

	return len;
}

static ssize_t sec_svc_enc_rw_read(struct bt_conn *conn, const struct bt_gatt_attr *attr, void *buf,
				   uint16_t len, uint16_t offset)
{
	ssize_t ret;

	sec_svc_enc_rw_on_read();

	k_mutex_lock(&sec_svc_enc_rw_lock, K_FOREVER);
	ret = bt_gatt_attr_read(conn, attr, buf, len, offset, sec_svc_enc_rw_value,
				sizeof(sec_svc_enc_rw_value));
	k_mutex_unlock(&sec_svc_enc_rw_lock);

	return ret;
}

static ssize_t sec_svc_enc_rw_write(struct bt_conn *conn, const struct bt_gatt_attr *attr,
				    const void *buf, uint16_t len, uint16_t offset, uint8_t flags)
{
	ARG_UNUSED(conn);
	ARG_UNUSED(attr);

	if (offset + len > sizeof(sec_svc_enc_rw_value)) {
		return BT_GATT_ERR(BT_ATT_ERR_INVALID_OFFSET);
	}

	/* Prepare writes only validate; the value is committed on execute. */
	if (flags & BT_GATT_WRITE_FLAG_PREPARE) {
		return 0;
	}

	k_mutex_lock(&sec_svc_enc_rw_lock, K_FOREVER);
	memcpy(sec_svc_enc_rw_value + offset, buf, len);
	k_mutex_unlock(&sec_svc_enc_rw_lock);

	sec_svc_enc_rw_on_write(sec_svc_enc_rw_value, sizeof(sec_svc_enc_rw_value));

	return len;
}

static ssize_t sec_svc_auth_read_read(struct bt_conn *conn, const struct bt_gatt_attr *attr,
				      void *buf, uint16_t len, uint16_t offset)
{
	ssize_t ret;

	sec_svc_auth_read_on_read();

	k_mutex_lock(&sec_svc_auth_read_lock, K_FOREVER);
	ret = bt_gatt_attr_read(conn, attr, buf, len, offset, sec_svc_auth_read_value,
				sizeof(sec_svc_auth_read_value));
	k_mutex_unlock(&sec_svc_auth_read_lock);

	return ret;
}

static ssize_t sec_svc_auth_rw_read(struct bt_conn *conn, const struct bt_gatt_attr *attr,
				    void *buf, uint16_t len, uint16_t offset)
{
	ssize_t ret;

	sec_svc_auth_rw_on_read();

	k_mutex_lock(&sec_svc_auth_rw_lock, K_FOREVER);
	ret = bt_gatt_attr_read(conn, attr, buf, len, offset, sec_svc_auth_rw_value,
				sizeof(sec_svc_auth_rw_value));
	k_mutex_unlock(&sec_svc_auth_rw_lock);

	return ret;
}

static ssize_t sec_svc_auth_rw_write(struct bt_conn *conn, const struct bt_gatt_attr *attr,
				     const void *buf, uint16_t len, uint16_t offset, uint8_t flags)
{
	ARG_UNUSED(conn);
	ARG_UNUSED(attr);

	if (offset + len > sizeof(sec_svc_auth_rw_value)) {
		return BT_GATT_ERR(BT_ATT_ERR_INVALID_OFFSET);
	}

	/* Prepare writes only validate; the value is committed on execute. */
	if (flags & BT_GATT_WRITE_FLAG_PREPARE) {
		return 0;
	}

	k_mutex_lock(&sec_svc_auth_rw_lock, K_FOREVER);
	memcpy(sec_svc_auth_rw_value + offset, buf, len);
	k_mutex_unlock(&sec_svc_auth_rw_lock);

	sec_svc_auth_rw_on_write(sec_svc_auth_rw_value, sizeof(sec_svc_auth_rw_value));

	return len;
}

static ssize_t sec_svc_lesc_rw_read(struct bt_conn *conn, const struct bt_gatt_attr *attr,
				    void *buf, uint16_t len, uint16_t offset)
{
	ssize_t ret;

	sec_svc_lesc_rw_on_read();

	k_mutex_lock(&sec_svc_lesc_rw_lock, K_FOREVER);
	ret = bt_gatt_attr_read(conn, attr, buf, len, offset, sec_svc_lesc_rw_value,
				sizeof(sec_svc_lesc_rw_value));
	k_mutex_unlock(&sec_svc_lesc_rw_lock);

	return ret;
}

static ssize_t sec_svc_lesc_rw_write(struct bt_conn *conn, const struct bt_gatt_attr *attr,
				     const void *buf, uint16_t len, uint16_t offset, uint8_t flags)
{
	ARG_UNUSED(conn);
	ARG_UNUSED(attr);

	if (offset + len > sizeof(sec_svc_lesc_rw_value)) {
		return BT_GATT_ERR(BT_ATT_ERR_INVALID_OFFSET);
	}

	/* Prepare writes only validate; the value is committed on execute. */
	if (flags & BT_GATT_WRITE_FLAG_PREPARE) {
		return 0;
	}

	k_mutex_lock(&sec_svc_lesc_rw_lock, K_FOREVER);
	memcpy(sec_svc_lesc_rw_value + offset, buf, len);
	k_mutex_unlock(&sec_svc_lesc_rw_lock);

	sec_svc_lesc_rw_on_write(sec_svc_lesc_rw_value, sizeof(sec_svc_lesc_rw_value));

	return len;
}

static ssize_t sec_svc_enc_notify_read(struct bt_conn *conn, const struct bt_gatt_attr *attr,
				       void *buf, uint16_t len, uint16_t offset)
{
	ssize_t ret;

	sec_svc_enc_notify_on_read();

	k_mutex_lock(&sec_svc_enc_notify_lock, K_FOREVER);
	ret = bt_gatt_attr_read(conn, attr, buf, len, offset, sec_svc_enc_notify_value,
				sizeof(sec_svc_enc_notify_value));
	k_mutex_unlock(&sec_svc_enc_notify_lock);

	return ret;
}

static void sec_svc_enc_notify_ccc_cfg_changed(const struct bt_gatt_attr *attr, uint16_t value)
{
	bool enabled = value == BT_GATT_CCC_NOTIFY;

	ARG_UNUSED(attr);

	printk("enc_notify notifications %s\n", enabled ? "enabled" : "disabled");

	sec_svc_enc_notify_on_ccc(enabled);
}

static ssize_t sec_svc_auth_indicate_read(struct bt_conn *conn, const struct bt_gatt_attr *attr,
					  void *buf, uint16_t len, uint16_t offset)
{
	ssize_t ret;

	sec_svc_auth_indicate_on_read();

	k_mutex_lock(&sec_svc_auth_indicate_lock, K_FOREVER);
	ret = bt_gatt_attr_read(conn, attr, buf, len, offset, sec_svc_auth_indicate_value,
				sizeof(sec_svc_auth_indicate_value));
	k_mutex_unlock(&sec_svc_auth_indicate_lock);

	return ret;
}

static void sec_svc_auth_indicate_ccc_cfg_changed(const struct bt_gatt_attr *attr, uint16_t value)
{
	bool enabled = value == BT_GATT_CCC_INDICATE;

	ARG_UNUSED(attr);

	printk("auth_indicate indications %s\n", enabled ? "enabled" : "disabled");

	sec_svc_auth_indicate_on_ccc(enabled);
}

/* ------------------------------------------------------------------------- */
/* Application hooks (weak defaults; override in your own sources)           */
/* ------------------------------------------------------------------------- */

__weak void sec_svc_enc_read_on_read(void)
{
}

__weak void sec_svc_enc_write_on_write(const uint8_t *data, uint16_t len)
{
	ARG_UNUSED(data);
	ARG_UNUSED(len);
}

__weak void sec_svc_enc_rw_on_read(void)
{
}
__weak void sec_svc_enc_rw_on_write(const uint8_t *data, uint16_t len)
{
	ARG_UNUSED(data);
	ARG_UNUSED(len);
}

__weak void sec_svc_auth_read_on_read(void)
{
}

__weak void sec_svc_auth_rw_on_read(void)
{
}
__weak void sec_svc_auth_rw_on_write(const uint8_t *data, uint16_t len)
{
	ARG_UNUSED(data);
	ARG_UNUSED(len);
}

__weak void sec_svc_lesc_rw_on_read(void)
{
}
__weak void sec_svc_lesc_rw_on_write(const uint8_t *data, uint16_t len)
{
	ARG_UNUSED(data);
	ARG_UNUSED(len);
}

__weak void sec_svc_enc_notify_on_read(void)
{
}
__weak void sec_svc_enc_notify_on_ccc(bool enabled)
{
	ARG_UNUSED(enabled);
}

__weak void sec_svc_auth_indicate_on_read(void)
{
}
__weak void sec_svc_auth_indicate_on_ccc(bool enabled)
{
	ARG_UNUSED(enabled);
}

/* ------------------------------------------------------------------------- */
/* Push helpers                                                              */
/* ------------------------------------------------------------------------- */

int sec_svc_enc_notify_notify(const uint8_t *data, uint16_t len)
{
	int err;

	err = sec_svc_enc_notify_set(data, len);
	if (err) {
		return err;
	}

	return bt_gatt_notify_uuid(NULL, SEC_SVC_ENC_NOTIFY_UUID, NULL, sec_svc_enc_notify_value,
				   len);
}

static struct bt_gatt_indicate_params sec_svc_auth_indicate_ind_params;

int sec_svc_auth_indicate_indicate(const uint8_t *data, uint16_t len)
{
	int err;

	err = sec_svc_auth_indicate_set(data, len);
	if (err) {
		return err;
	}

	sec_svc_auth_indicate_ind_params.uuid = SEC_SVC_AUTH_INDICATE_UUID;
	sec_svc_auth_indicate_ind_params.attr = NULL;
	sec_svc_auth_indicate_ind_params.data = sec_svc_auth_indicate_value;
	sec_svc_auth_indicate_ind_params.len = len;

	return bt_gatt_indicate(NULL, &sec_svc_auth_indicate_ind_params);
}

/* ------------------------------------------------------------------------- */
/* Service declaration                                                       */
/* ------------------------------------------------------------------------- */

/* clang-format off */
BT_GATT_SERVICE_DEFINE(sec_svc,
	BT_GATT_PRIMARY_SERVICE(SEC_SVC_UUID),

	/* enc_read: read */
	BT_GATT_CHARACTERISTIC(SEC_SVC_ENC_READ_UUID,
			       BT_GATT_CHRC_READ,
			       BT_GATT_PERM_READ_ENCRYPT,
			       sec_svc_enc_read_read,
			       NULL,
			       sec_svc_enc_read_value),

	/* enc_write: write */
	BT_GATT_CHARACTERISTIC(SEC_SVC_ENC_WRITE_UUID,
			       BT_GATT_CHRC_WRITE,
			       BT_GATT_PERM_WRITE_ENCRYPT,
			       NULL,
			       sec_svc_enc_write_write,
			       sec_svc_enc_write_value),

	/* enc_rw: read, write */
	BT_GATT_CHARACTERISTIC(SEC_SVC_ENC_RW_UUID,
			       BT_GATT_CHRC_READ | BT_GATT_CHRC_WRITE,
			       BT_GATT_PERM_READ_ENCRYPT | BT_GATT_PERM_WRITE_ENCRYPT,
			       sec_svc_enc_rw_read,
			       sec_svc_enc_rw_write,
			       sec_svc_enc_rw_value),

	/* auth_read: read */
	BT_GATT_CHARACTERISTIC(SEC_SVC_AUTH_READ_UUID,
			       BT_GATT_CHRC_READ,
			       BT_GATT_PERM_READ_AUTHEN,
			       sec_svc_auth_read_read,
			       NULL,
			       sec_svc_auth_read_value),

	/* auth_rw: read, write */
	BT_GATT_CHARACTERISTIC(SEC_SVC_AUTH_RW_UUID,
			       BT_GATT_CHRC_READ | BT_GATT_CHRC_WRITE,
			       BT_GATT_PERM_READ_AUTHEN | BT_GATT_PERM_WRITE_AUTHEN,
			       sec_svc_auth_rw_read,
			       sec_svc_auth_rw_write,
			       sec_svc_auth_rw_value),

	/* lesc_rw: read, write */
	BT_GATT_CHARACTERISTIC(SEC_SVC_LESC_RW_UUID,
			       BT_GATT_CHRC_READ | BT_GATT_CHRC_WRITE,
			       BT_GATT_PERM_READ_LESC | BT_GATT_PERM_WRITE_LESC,
			       sec_svc_lesc_rw_read,
			       sec_svc_lesc_rw_write,
			       sec_svc_lesc_rw_value),

	/* enc_notify: read, notify */
	BT_GATT_CHARACTERISTIC(SEC_SVC_ENC_NOTIFY_UUID,
			       BT_GATT_CHRC_READ | BT_GATT_CHRC_NOTIFY,
			       BT_GATT_PERM_READ_ENCRYPT,
			       sec_svc_enc_notify_read,
			       NULL,
			       sec_svc_enc_notify_value),
	BT_GATT_CCC(sec_svc_enc_notify_ccc_cfg_changed, BT_GATT_PERM_READ | BT_GATT_PERM_WRITE),

	/* auth_indicate: read, indicate */
	BT_GATT_CHARACTERISTIC(SEC_SVC_AUTH_INDICATE_UUID,
			       BT_GATT_CHRC_READ | BT_GATT_CHRC_INDICATE,
			       BT_GATT_PERM_READ_AUTHEN,
			       sec_svc_auth_indicate_read,
			       NULL,
			       sec_svc_auth_indicate_value),
	BT_GATT_CCC(sec_svc_auth_indicate_ccc_cfg_changed, BT_GATT_PERM_READ | BT_GATT_PERM_WRITE),
);
/* clang-format on */
```
