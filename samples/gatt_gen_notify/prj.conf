## CMakeLists.txt
```
cmake_minimum_required(VERSION 3.20.0)

find_package(Zephyr REQUIRED HINTS $ENV{ZEPHYR_BASE})
project(gatt_gen_notify)

target_sources(app PRIVATE src/main.c)
target_sources(app PRIVATE src/notify_svc_service.c)
```

## sample.yaml
```
sample:
  name: GATT Generated gatt_gen_notify

tests:
  sample.bluetooth.ble_gatt_generator_gatt_gen_notify:
    build_only: true
    platform_allow:
      - native_sim
      - nrf52_bsim/native
    tags: bluetooth
```

## prj.conf
```kconfig
# Minimal Kconfig for the gatt_gen_notify profile.
# See KCONFIG_NOTES.md for why each symbol is required.
CONFIG_BT=y
CONFIG_BT_DEVICE_NAME="GATT Gen gatt_gen_notify"
CONFIG_BT_PERIPHERAL=y
CONFIG_BT_ATT_PREPARE_COUNT=2
# (advisory) CONFIG_BT_GATT_NOTIFY_MULTIPLE=y — Optional: batch notifications when several CCCs are enabled at once
CONFIG_LOG=y
CONFIG_BT_DEVICE_APPEARANCE=0
```

## src/main.c
```c
/*
 * Copyright (c) 2026 Ankit Modi
 *
 * SPDX-License-Identifier: Apache-2.0
 */

/** @file
 *  @brief Sample application for the generated gatt_gen_notify GATT profile.
 *
 *  Generated once by ble-gatt-generator. This file is yours to edit; it is
 *  not overwritten on regeneration unless --force is given.
 */

#include <zephyr/bluetooth/bluetooth.h>
#include <zephyr/bluetooth/conn.h>
#include <zephyr/bluetooth/gatt.h>
#include <zephyr/bluetooth/uuid.h>
#include <zephyr/kernel.h>
#include <zephyr/sys/printk.h>

#include "notify_svc_service.h"

/* Advertise the first service UUID so scanners can filter on it. */
static const struct bt_data ad[] = {
	BT_DATA_BYTES(BT_DATA_FLAGS, (BT_LE_AD_GENERAL | BT_LE_AD_NO_BREDR)),
	BT_DATA_BYTES(BT_DATA_UUID128_ALL, BT_UUID_128_ENCODE(0x12345678, 0x1234, 0x5678, 0x1234, 0x56789abcdef0)),
};

static const struct bt_data sd[] = {
	BT_DATA(BT_DATA_NAME_COMPLETE, CONFIG_BT_DEVICE_NAME, sizeof(CONFIG_BT_DEVICE_NAME) - 1),
};

int main(void)
{
	int err;

	err = bt_enable(NULL);
	if (err) {
		printk("Bluetooth init failed (err %d)\n", err);
		return 0;
	}

	printk("Bluetooth initialized\n");

	err = bt_le_adv_start(BT_LE_ADV_CONN_FAST_1, ad, ARRAY_SIZE(ad), sd, ARRAY_SIZE(sd));
	if (err) {
		printk("Advertising failed to start (err %d)\n", err);
		return 0;
	}

	printk("Advertising successfully started\n");

	while (1) {
		k_sleep(K_SECONDS(1));
	}

	return 0;
}
```

## src/notify_svc_service.c
```c
/*
 * Copyright (c) 2026 Ankit Modi
 *
 * SPDX-License-Identifier: Apache-2.0
 */

/** @file
 *  @brief gatt_gen_notify GATT service implementation (notify_svc).
 *
 *  Auto-generated by ble-gatt-generator; do not edit. Put application logic in
 *  main.c or your own sources and call the public helpers declared in
 *  notify_svc_service.h.
 */

#include <errno.h>
#include <stdint.h>
#include <string.h>

#include <zephyr/kernel.h>
#include <zephyr/sys/printk.h>
#include <zephyr/bluetooth/bluetooth.h>
#include <zephyr/bluetooth/gatt.h>
#include <zephyr/bluetooth/uuid.h>

#include "notify_svc_service.h"

/* ------------------------------------------------------------------------- */
/* Characteristic value storage                                              */
/* ------------------------------------------------------------------------- */

static uint8_t notify_svc_button_value[NOTIFY_SVC_BUTTON_SIZE];
static K_MUTEX_DEFINE(notify_svc_button_lock);
static uint8_t notify_svc_led_value[NOTIFY_SVC_LED_SIZE];
static K_MUTEX_DEFINE(notify_svc_led_lock);

/* ------------------------------------------------------------------------- */
/* Static descriptor payloads                                                */
/* ------------------------------------------------------------------------- */

static const struct bt_gatt_cpf notify_svc_button_cpf = {
	.format = 1,
	.exponent = 0,
	.unit = 0,
	.name_space = 1,
	.description = 0,
};
static const struct bt_gatt_cep notify_svc_led_cep = {
	.properties = BT_GATT_CEP_RELIABLE_WRITE,
};

/* ------------------------------------------------------------------------- */
/* Thread-safe accessors                                                     */
/* ------------------------------------------------------------------------- */

int notify_svc_button_set(const uint8_t *data, uint16_t len)
{
	if (data == NULL || len > sizeof(notify_svc_button_value)) {
		return -EINVAL;
	}

	k_mutex_lock(&notify_svc_button_lock, K_FOREVER);
	memcpy(notify_svc_button_value, data, len);
	k_mutex_unlock(&notify_svc_button_lock);

	return 0;
}

int notify_svc_button_get(uint8_t *data, uint16_t len)
{
	if (data == NULL) {
		return -EINVAL;
	}
	if (len > sizeof(notify_svc_button_value)) {
		return -EINVAL;
	}

	k_mutex_lock(&notify_svc_button_lock, K_FOREVER);
	memcpy(data, notify_svc_button_value, MIN(len, sizeof(notify_svc_button_value)));
	k_mutex_unlock(&notify_svc_button_lock);

	return 0;
}

int notify_svc_led_set(const uint8_t *data, uint16_t len)
{
	if (data == NULL || len > sizeof(notify_svc_led_value)) {
		return -EINVAL;
	}

	k_mutex_lock(&notify_svc_led_lock, K_FOREVER);
	memcpy(notify_svc_led_value, data, len);
	k_mutex_unlock(&notify_svc_led_lock);

	return 0;
}

int notify_svc_led_get(uint8_t *data, uint16_t len)
{
	if (data == NULL) {
		return -EINVAL;
	}
	if (len > sizeof(notify_svc_led_value)) {
		return -EINVAL;
	}

	k_mutex_lock(&notify_svc_led_lock, K_FOREVER);
	memcpy(data, notify_svc_led_value, MIN(len, sizeof(notify_svc_led_value)));
	k_mutex_unlock(&notify_svc_led_lock);

	return 0;
}

/* ------------------------------------------------------------------------- */
/* GATT attribute callbacks                                                  */
/* ------------------------------------------------------------------------- */

static ssize_t notify_svc_button_read(struct bt_conn *conn, const struct bt_gatt_attr *attr,
				      void *buf, uint16_t len, uint16_t offset)
{
	ssize_t ret;

	notify_svc_button_on_read();

	k_mutex_lock(&notify_svc_button_lock, K_FOREVER);
	ret = bt_gatt_attr_read(conn, attr, buf, len, offset, notify_svc_button_value,
				sizeof(notify_svc_button_value));
	k_mutex_unlock(&notify_svc_button_lock);

	return ret;
}

static void notify_svc_button_ccc_cfg_changed(const struct bt_gatt_attr *attr, uint16_t value)
{
	bool enabled = value == BT_GATT_CCC_NOTIFY;

	ARG_UNUSED(attr);

	printk("button notifications %s\n", enabled ? "enabled" : "disabled");

	notify_svc_button_on_ccc(enabled);
}

static ssize_t notify_svc_led_read(struct bt_conn *conn, const struct bt_gatt_attr *attr, void *buf,
				   uint16_t len, uint16_t offset)
{
	ssize_t ret;

	notify_svc_led_on_read();

	k_mutex_lock(&notify_svc_led_lock, K_FOREVER);
	ret = bt_gatt_attr_read(conn, attr, buf, len, offset, notify_svc_led_value,
				sizeof(notify_svc_led_value));
	k_mutex_unlock(&notify_svc_led_lock);

	return ret;
}

static ssize_t notify_svc_led_write(struct bt_conn *conn, const struct bt_gatt_attr *attr,
				    const void *buf, uint16_t len, uint16_t offset, uint8_t flags)
{
	ARG_UNUSED(conn);
	ARG_UNUSED(attr);

	if (offset + len > sizeof(notify_svc_led_value)) {
		return BT_GATT_ERR(BT_ATT_ERR_INVALID_OFFSET);
	}

	/* Prepare writes only validate; the value is committed on execute. */
	if (flags & BT_GATT_WRITE_FLAG_PREPARE) {
		return 0;
	}

	k_mutex_lock(&notify_svc_led_lock, K_FOREVER);
	memcpy(notify_svc_led_value + offset, buf, len);
	k_mutex_unlock(&notify_svc_led_lock);

	notify_svc_led_on_write(notify_svc_led_value, sizeof(notify_svc_led_value));

	return len;
}

/* ------------------------------------------------------------------------- */
/* Application hooks (weak defaults; override in your own sources)           */
/* ------------------------------------------------------------------------- */

__weak void notify_svc_button_on_read(void)
{
}
__weak void notify_svc_button_on_ccc(bool enabled)
{
	ARG_UNUSED(enabled);
}

__weak void notify_svc_led_on_read(void)
{
}
__weak void notify_svc_led_on_write(const uint8_t *data, uint16_t len)
{
	ARG_UNUSED(data);
	ARG_UNUSED(len);
}

/* ------------------------------------------------------------------------- */
/* Push helpers                                                              */
/* ------------------------------------------------------------------------- */

int notify_svc_button_notify(const uint8_t *data, uint16_t len)
{
	int err;

	err = notify_svc_button_set(data, len);
	if (err) {
		return err;
	}

	return bt_gatt_notify_uuid(NULL, NOTIFY_SVC_BUTTON_UUID, NULL, notify_svc_button_value,
				   len);
}

/* ------------------------------------------------------------------------- */
/* Service declaration                                                       */
/* ------------------------------------------------------------------------- */

/* clang-format off */
BT_GATT_SERVICE_DEFINE(notify_svc,
	BT_GATT_PRIMARY_SERVICE(NOTIFY_SVC_UUID),

	/* button: read, notify */
	BT_GATT_CHARACTERISTIC(NOTIFY_SVC_BUTTON_UUID,
			       BT_GATT_CHRC_READ | BT_GATT_CHRC_NOTIFY,
			       BT_GATT_PERM_READ,
			       notify_svc_button_read,
			       NULL,
			       notify_svc_button_value),
	BT_GATT_CUD("Button state", BT_GATT_PERM_READ),
	BT_GATT_CPF(&notify_svc_button_cpf),
	BT_GATT_CCC(notify_svc_button_ccc_cfg_changed, BT_GATT_PERM_READ | BT_GATT_PERM_WRITE),

	/* led: read, write, extended_properties */
	BT_GATT_CHARACTERISTIC(NOTIFY_SVC_LED_UUID,
			       BT_GATT_CHRC_READ | BT_GATT_CHRC_WRITE | BT_GATT_CHRC_EXT_PROP,
			       BT_GATT_PERM_READ | BT_GATT_PERM_WRITE | BT_GATT_PERM_PREPARE_WRITE,
			       notify_svc_led_read,
			       notify_svc_led_write,
			       notify_svc_led_value),
	BT_GATT_CUD("LED control", BT_GATT_PERM_READ),
	BT_GATT_CEP(&notify_svc_led_cep),
);
/* clang-format on */
```

## src/notify_svc_service.h
```c
/*
 * Copyright (c) 2026 Ankit Modi
 *
 * SPDX-License-Identifier: Apache-2.0
 */

/** @file
 *  @brief gatt_gen_notify GATT service public API (notify_svc).
 *
 *  Auto-generated by ble-gatt-generator; do not edit.
 */

#ifndef BLE_GATT_GENERATOR_NOTIFY_SVC_H_
#define BLE_GATT_GENERATOR_NOTIFY_SVC_H_

#include <stdbool.h>
#include <stdint.h>

#include <zephyr/bluetooth/uuid.h>

#ifdef __cplusplus
extern "C" {
#endif

/** @defgroup notify_svc notify_svc service
 *  @brief Generated helpers for the notify_svc GATT service.
 *  @{
 */

/* Service and characteristic UUIDs. */
#define NOTIFY_SVC_UUID                                                                            \
	BT_UUID_DECLARE_128(BT_UUID_128_ENCODE(0x12345678, 0x1234, 0x5678, 0x1234, 0x56789abcdef0))
#define NOTIFY_SVC_BUTTON_UUID                                                                     \
	BT_UUID_DECLARE_128(BT_UUID_128_ENCODE(0x12345678, 0x1234, 0x5678, 0x1234, 0x56789abcdef1))
#define NOTIFY_SVC_LED_UUID                                                                        \
	BT_UUID_DECLARE_128(BT_UUID_128_ENCODE(0x12345678, 0x1234, 0x5678, 0x1234, 0x56789abcdef2))

/* Characteristic value sizes in bytes. */
#define NOTIFY_SVC_BUTTON_SIZE 1
#define NOTIFY_SVC_LED_SIZE    1

/** @brief Set the button characteristic value.
 *
 *  Thread-safe when @c thread_safe is enabled for this characteristic.
 *
 *  @param data Pointer to the data to copy into the value buffer.
 *  @param len  Number of bytes to copy; must not exceed
 *              NOTIFY_SVC_BUTTON_SIZE.
 *
 *  @retval 0 on success.
 *  @retval -EINVAL if @p data is NULL or @p len is too large.
 */
int notify_svc_button_set(const uint8_t *data, uint16_t len);

/** @brief Get the button characteristic value.
 *
 *  @param data Buffer to receive the value.
 *  @param len  Number of bytes to copy; must not exceed
 *              NOTIFY_SVC_BUTTON_SIZE.
 *
 *  @retval 0 on success.
 *  @retval -EINVAL if @p data is NULL or @p len is too large.
 */
int notify_svc_button_get(uint8_t *data, uint16_t len);

/** @brief Application hook called before a peer reads button.
 *
 *  Defined as a weak no-op in the generated source. Define it in your own
 *  code to refresh the value or gate the read; it runs from the Bluetooth
 *  RX context, so keep it short.
 */
void notify_svc_button_on_read(void);

/** @brief Update and notify the button characteristic.
 *
 *  @param data Pointer to the new value.
 *  @param len  Length of the data in bytes.
 *
 *  @return 0 on success, or a negative error code (see bt_gatt_notify_uuid()).
 */
int notify_svc_button_notify(const uint8_t *data, uint16_t len);

/** @brief Application hook called when button CCC state changes.
 *
 *  Defined as a weak no-op in the generated source. Define it in your own
 *  code to react to a peer enabling/disabling
 *  notifications.
 *
 *  @param enabled True when notifications were enabled.
 */
void notify_svc_button_on_ccc(bool enabled);

/** @brief Set the led characteristic value.
 *
 *  Thread-safe when @c thread_safe is enabled for this characteristic.
 *
 *  @param data Pointer to the data to copy into the value buffer.
 *  @param len  Number of bytes to copy; must not exceed
 *              NOTIFY_SVC_LED_SIZE.
 *
 *  @retval 0 on success.
 *  @retval -EINVAL if @p data is NULL or @p len is too large.
 */
int notify_svc_led_set(const uint8_t *data, uint16_t len);

/** @brief Get the led characteristic value.
 *
 *  @param data Buffer to receive the value.
 *  @param len  Number of bytes to copy; must not exceed
 *              NOTIFY_SVC_LED_SIZE.
 *
 *  @retval 0 on success.
 *  @retval -EINVAL if @p data is NULL or @p len is too large.
 */
int notify_svc_led_get(uint8_t *data, uint16_t len);

/** @brief Application hook called before a peer reads led.
 *
 *  Defined as a weak no-op in the generated source. Define it in your own
 *  code to refresh the value or gate the read; it runs from the Bluetooth
 *  RX context, so keep it short.
 */
void notify_svc_led_on_read(void);

/** @brief Application hook called after a peer writes led.
 *
 *  Defined as a weak no-op in the generated source. Define this function in
 *  your own code to react to remote writes; it is called outside the value
 *  lock from the Bluetooth RX context, so keep it short.
 *
 *  @param data Pointer to the (already updated) value buffer.
 *  @param len  Size of the value buffer in bytes.
 */
void notify_svc_led_on_write(const uint8_t *data, uint16_t len);

/** @} */

#ifdef __cplusplus
}
#endif

#endif /* BLE_GATT_GENERATOR_NOTIFY_SVC_H_ */
```
