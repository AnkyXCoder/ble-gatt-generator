## CMakeLists.txt
```
cmake_minimum_required(VERSION 3.20.0)

find_package(Zephyr REQUIRED HINTS $ENV{ZEPHYR_BASE})
project(gatt_gen_secure)

target_sources(app PRIVATE src/main.c)
target_sources(app PRIVATE src/secure_svc_service.c)
```

## sample.yaml
```
sample:
  name: GATT Generated gatt_gen_secure

tests:
  sample.bluetooth.ble_gatt_generator_gatt_gen_secure:
    build_only: true
    platform_allow:
      - native_sim
      - nrf52_bsim/native
    tags: bluetooth
```

## prj.conf
```kconfig
# Minimal Kconfig for the gatt_gen_secure profile.
# See KCONFIG_NOTES.md for why each symbol is required.
CONFIG_BT=y
CONFIG_BT_DEVICE_NAME="GATT Gen gatt_gen_secure"
CONFIG_BT_PERIPHERAL=y
CONFIG_BT_SMP=y
CONFIG_LOG=y
CONFIG_BT_DEVICE_APPEARANCE=0
```

## src/main.c
```c
/*
 * Copyright (c) 2026 Ankit Modi
 *
 * SPDX-License-Identifier: Apache-2.0
 */

/** @file
 *  @brief Sample application for the generated gatt_gen_secure GATT profile.
 *
 *  Generated once by ble-gatt-generator. This file is yours to edit; it is
 *  not overwritten on regeneration unless --force is given.
 */

#include <zephyr/bluetooth/bluetooth.h>
#include <zephyr/bluetooth/conn.h>
#include <zephyr/bluetooth/gatt.h>
#include <zephyr/bluetooth/uuid.h>
#include <zephyr/kernel.h>
#include <zephyr/sys/printk.h>

#include "secure_svc_service.h"

/* Advertise the first service UUID so scanners can filter on it. */
static const struct bt_data ad[] = {
	BT_DATA_BYTES(BT_DATA_FLAGS, (BT_LE_AD_GENERAL | BT_LE_AD_NO_BREDR)),
	BT_DATA_BYTES(BT_DATA_UUID128_ALL, BT_UUID_128_ENCODE(0x12345678, 0x1234, 0x5678, 0x1234, 0x56789abcdef0)),
};

static const struct bt_data sd[] = {
	BT_DATA(BT_DATA_NAME_COMPLETE, CONFIG_BT_DEVICE_NAME, sizeof(CONFIG_BT_DEVICE_NAME) - 1),
};

int main(void)
{
	int err;

	err = bt_enable(NULL);
	if (err) {
		printk("Bluetooth init failed (err %d)\n", err);
		return 0;
	}

	printk("Bluetooth initialized\n");

	err = bt_le_adv_start(BT_LE_ADV_CONN_FAST_1, ad, ARRAY_SIZE(ad), sd, ARRAY_SIZE(sd));
	if (err) {
		printk("Advertising failed to start (err %d)\n", err);
		return 0;
	}

	printk("Advertising successfully started\n");

	while (1) {
		k_sleep(K_SECONDS(1));
	}

	return 0;
}
```

## src/secure_svc_service.c
```c
/*
 * Copyright (c) 2026 Ankit Modi
 *
 * SPDX-License-Identifier: Apache-2.0
 */

/** @file
 *  @brief gatt_gen_secure GATT service implementation (secure_svc).
 *
 *  Auto-generated by ble-gatt-generator; do not edit. Put application logic in
 *  main.c or your own sources and call the public helpers declared in
 *  secure_svc_service.h.
 */

#include <errno.h>
#include <stdint.h>
#include <string.h>

#include <zephyr/kernel.h>
#include <zephyr/sys/printk.h>
#include <zephyr/bluetooth/bluetooth.h>
#include <zephyr/bluetooth/gatt.h>
#include <zephyr/bluetooth/uuid.h>

#include "secure_svc_service.h"

/* ------------------------------------------------------------------------- */
/* Characteristic value storage                                              */
/* ------------------------------------------------------------------------- */

static uint8_t secure_svc_secret_value[SECURE_SVC_SECRET_SIZE];
static K_MUTEX_DEFINE(secure_svc_secret_lock);

/* ------------------------------------------------------------------------- */
/* Static descriptor payloads                                                */
/* ------------------------------------------------------------------------- */

/* ------------------------------------------------------------------------- */
/* Thread-safe accessors                                                     */
/* ------------------------------------------------------------------------- */

int secure_svc_secret_set(const uint8_t *data, uint16_t len)
{
	if (data == NULL || len > sizeof(secure_svc_secret_value)) {
		return -EINVAL;
	}

	k_mutex_lock(&secure_svc_secret_lock, K_FOREVER);
	memcpy(secure_svc_secret_value, data, len);
	k_mutex_unlock(&secure_svc_secret_lock);

	return 0;
}

int secure_svc_secret_get(uint8_t *data, uint16_t len)
{
	if (data == NULL) {
		return -EINVAL;
	}
	if (len > sizeof(secure_svc_secret_value)) {
		return -EINVAL;
	}

	k_mutex_lock(&secure_svc_secret_lock, K_FOREVER);
	memcpy(data, secure_svc_secret_value, MIN(len, sizeof(secure_svc_secret_value)));
	k_mutex_unlock(&secure_svc_secret_lock);

	return 0;
}

/* ------------------------------------------------------------------------- */
/* GATT attribute callbacks                                                  */
/* ------------------------------------------------------------------------- */

static ssize_t secure_svc_secret_read(struct bt_conn *conn, const struct bt_gatt_attr *attr,
				      void *buf, uint16_t len, uint16_t offset)
{
	ssize_t ret;

	secure_svc_secret_on_read();

	k_mutex_lock(&secure_svc_secret_lock, K_FOREVER);
	ret = bt_gatt_attr_read(conn, attr, buf, len, offset, secure_svc_secret_value,
				sizeof(secure_svc_secret_value));
	k_mutex_unlock(&secure_svc_secret_lock);

	return ret;
}

static ssize_t secure_svc_secret_write(struct bt_conn *conn, const struct bt_gatt_attr *attr,
				       const void *buf, uint16_t len, uint16_t offset,
				       uint8_t flags)
{
	ARG_UNUSED(conn);
	ARG_UNUSED(attr);

	if (offset + len > sizeof(secure_svc_secret_value)) {
		return BT_GATT_ERR(BT_ATT_ERR_INVALID_OFFSET);
	}

	/* Prepare writes only validate; the value is committed on execute. */
	if (flags & BT_GATT_WRITE_FLAG_PREPARE) {
		return 0;
	}

	k_mutex_lock(&secure_svc_secret_lock, K_FOREVER);
	memcpy(secure_svc_secret_value + offset, buf, len);
	k_mutex_unlock(&secure_svc_secret_lock);

	secure_svc_secret_on_write(secure_svc_secret_value, sizeof(secure_svc_secret_value));

	return len;
}

/* ------------------------------------------------------------------------- */
/* Application hooks (weak defaults; override in your own sources)           */
/* ------------------------------------------------------------------------- */

__weak void secure_svc_secret_on_read(void)
{
}
__weak void secure_svc_secret_on_write(const uint8_t *data, uint16_t len)
{
	ARG_UNUSED(data);
	ARG_UNUSED(len);
}

/* ------------------------------------------------------------------------- */
/* Push helpers                                                              */
/* ------------------------------------------------------------------------- */

/* ------------------------------------------------------------------------- */
/* Service declaration                                                       */
/* ------------------------------------------------------------------------- */

/* clang-format off */
BT_GATT_SERVICE_DEFINE(secure_svc,
	BT_GATT_PRIMARY_SERVICE(SECURE_SVC_UUID),

	/* secret: read, write */
	BT_GATT_CHARACTERISTIC(SECURE_SVC_SECRET_UUID,
			       BT_GATT_CHRC_READ | BT_GATT_CHRC_WRITE,
			       BT_GATT_PERM_READ_ENCRYPT | BT_GATT_PERM_WRITE_ENCRYPT,
			       secure_svc_secret_read,
			       secure_svc_secret_write,
			       secure_svc_secret_value),
);
/* clang-format on */
```

## src/secure_svc_service.h
```c
/*
 * Copyright (c) 2026 Ankit Modi
 *
 * SPDX-License-Identifier: Apache-2.0
 */

/** @file
 *  @brief gatt_gen_secure GATT service public API (secure_svc).
 *
 *  Auto-generated by ble-gatt-generator; do not edit.
 */

#ifndef BLE_GATT_GENERATOR_SECURE_SVC_H_
#define BLE_GATT_GENERATOR_SECURE_SVC_H_

#include <stdbool.h>
#include <stdint.h>

#include <zephyr/bluetooth/uuid.h>

#ifdef __cplusplus
extern "C" {
#endif

/** @defgroup secure_svc secure_svc service
 *  @brief Generated helpers for the secure_svc GATT service.
 *  @{
 */

/* Service and characteristic UUIDs. */
#define SECURE_SVC_UUID                                                                            \
	BT_UUID_DECLARE_128(BT_UUID_128_ENCODE(0x12345678, 0x1234, 0x5678, 0x1234, 0x56789abcdef0))
#define SECURE_SVC_SECRET_UUID                                                                     \
	BT_UUID_DECLARE_128(BT_UUID_128_ENCODE(0x12345678, 0x1234, 0x5678, 0x1234, 0x56789abcdef1))

/* Characteristic value sizes in bytes. */
#define SECURE_SVC_SECRET_SIZE 16

/** @brief Set the secret characteristic value.
 *
 *  Thread-safe when @c thread_safe is enabled for this characteristic.
 *
 *  @param data Pointer to the data to copy into the value buffer.
 *  @param len  Number of bytes to copy; must not exceed
 *              SECURE_SVC_SECRET_SIZE.
 *
 *  @retval 0 on success.
 *  @retval -EINVAL if @p data is NULL or @p len is too large.
 */
int secure_svc_secret_set(const uint8_t *data, uint16_t len);

/** @brief Get the secret characteristic value.
 *
 *  @param data Buffer to receive the value.
 *  @param len  Number of bytes to copy; must not exceed
 *              SECURE_SVC_SECRET_SIZE.
 *
 *  @retval 0 on success.
 *  @retval -EINVAL if @p data is NULL or @p len is too large.
 */
int secure_svc_secret_get(uint8_t *data, uint16_t len);

/** @brief Application hook called before a peer reads secret.
 *
 *  Defined as a weak no-op in the generated source. Define it in your own
 *  code to refresh the value or gate the read; it runs from the Bluetooth
 *  RX context, so keep it short.
 */
void secure_svc_secret_on_read(void);

/** @brief Application hook called after a peer writes secret.
 *
 *  Defined as a weak no-op in the generated source. Define this function in
 *  your own code to react to remote writes; it is called outside the value
 *  lock from the Bluetooth RX context, so keep it short.
 *
 *  @param data Pointer to the (already updated) value buffer.
 *  @param len  Size of the value buffer in bytes.
 */
void secure_svc_secret_on_write(const uint8_t *data, uint16_t len);

/** @} */

#ifdef __cplusplus
}
#endif

#endif /* BLE_GATT_GENERATOR_SECURE_SVC_H_ */
```
