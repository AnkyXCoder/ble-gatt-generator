## CMakeLists.txt
```
# SPDX-License-Identifier: Apache-2.0

# BabbleSim self-test for the generated gatt_gen_multi GATT profile.
# Build for nrf52_bsim and run with ./run_test.sh (requires a compiled
# BabbleSim at ${ZEPHYR_BASE}/../tools/bsim or $BSIM_OUT_PATH).

cmake_minimum_required(VERSION 3.20.0)

find_package(Zephyr REQUIRED HINTS $ENV{ZEPHYR_BASE})
project(bsim_test_gatt_gen_multi)

add_subdirectory(${ZEPHYR_BASE}/tests/bsim/babblekit babblekit)
target_link_libraries(app PRIVATE babblekit)

FILE(GLOB app_sources src/*.c)
target_sources(app PRIVATE ${app_sources})

# The generated GATT services under test live in the parent sample.
target_sources(app PRIVATE ${CMAKE_CURRENT_SOURCE_DIR}/../src/sensor_svc_service.c)
target_sources(app PRIVATE ${CMAKE_CURRENT_SOURCE_DIR}/../src/device_svc_service.c)
target_include_directories(app PRIVATE ${CMAKE_CURRENT_SOURCE_DIR}/../src)

zephyr_include_directories(
  ${BSIM_COMPONENTS_PATH}/libUtilv1/src/
  ${BSIM_COMPONENTS_PATH}/libPhyComv1/src/
  )
```

## prj.conf
```kconfig
# BabbleSim self-test: one binary plays both the peripheral running the
# generated GATT services and the central that verifies them.
CONFIG_BT=y
CONFIG_BT_PERIPHERAL=y
CONFIG_BT_CENTRAL=y
CONFIG_BT_OBSERVER=y
CONFIG_BT_GATT_CLIENT=y
CONFIG_BT_GATT_AUTO_DISCOVER_CCC=y
CONFIG_BT_DEVICE_NAME="GATT Gen gatt_gen_multi"
CONFIG_ASSERT=y
CONFIG_LOG=y
```

## src/main.c
```c
/*
 * Copyright (c) 2026 Ankit Modi
 *
 * SPDX-License-Identifier: Apache-2.0
 */

/** @file
 *  @brief BabbleSim test entry point for the generated gatt_gen_multi profile.
 *
 *  Auto-generated by ble-gatt-generator; do not edit.
 */

#include "bstests.h"

extern struct bst_test_list *test_peripheral_install(struct bst_test_list *tests);
extern struct bst_test_list *test_central_install(struct bst_test_list *tests);

bst_test_install_t test_installers[] = {test_peripheral_install, test_central_install, NULL};

int main(void)
{
	bst_main();
	return 0;
}
```

## src/central.c
```c
/*
 * Copyright (c) 2026 Ankit Modi
 *
 * SPDX-License-Identifier: Apache-2.0
 */

/** @file
 *  @brief BabbleSim central role for the gatt_gen_multi self-test.
 *
 *  Scans for the peripheral, connects, discovers every generated
 *  characteristic by UUID, reads readable values, writes and reads back
 *  writable values, and subscribes to all notify/indicate characteristics.
 *
 *  Auto-generated by ble-gatt-generator; do not edit.
 */

#include <stddef.h>
#include <errno.h>
#include <string.h>

#include <zephyr/kernel.h>
#include <zephyr/types.h>
#include <zephyr/sys/util.h>
#include <zephyr/bluetooth/bluetooth.h>
#include <zephyr/bluetooth/conn.h>
#include <zephyr/bluetooth/uuid.h>
#include <zephyr/bluetooth/gatt.h>

#include "babblekit/testcase.h"
#include "babblekit/flags.h"
#include "babblekit/sync.h"

#include "sensor_svc_service.h"
#include "device_svc_service.h"

/* Notifications the peripheral pushes per characteristic. */
#define NOTIFICATION_COUNT 5
/* How long to wait for asynchronous results, in poll iterations. */
#define WAIT_ITERS         500

DEFINE_FLAG_STATIC(flag_is_connected);
DEFINE_FLAG_STATIC(flag_discover_done);
DEFINE_FLAG_STATIC(flag_read_done);
DEFINE_FLAG_STATIC(flag_write_done);
DEFINE_FLAG_STATIC(sensor_svc_temperature_subscribed);
DEFINE_FLAG_STATIC(sensor_svc_humidity_subscribed);
DEFINE_FLAG_STATIC(device_svc_event_flag_subscribed);

static struct bt_conn *g_conn;

/* ------------------------------------------------------------------ */
/* Connection handling                                                 */
/* ------------------------------------------------------------------ */

static void connected(struct bt_conn *conn, uint8_t err)
{
	char addr[BT_ADDR_LE_STR_LEN];

	bt_addr_le_to_str(bt_conn_get_dst(conn), addr, sizeof(addr));

	if (err != 0) {
		TEST_FAIL("Failed to connect to %s (%u)", addr, err);
		return;
	}

	printk("Connected to %s\n", addr);
	SET_FLAG(flag_is_connected);
}

static void disconnected(struct bt_conn *conn, uint8_t reason)
{
	char addr[BT_ADDR_LE_STR_LEN];

	if (conn != g_conn) {
		return;
	}

	bt_addr_le_to_str(bt_conn_get_dst(conn), addr, sizeof(addr));

	printk("Disconnected: %s (reason 0x%02x)\n", addr, reason);

	bt_conn_unref(g_conn);
	g_conn = NULL;
	UNSET_FLAG(flag_is_connected);
}

BT_CONN_CB_DEFINE(conn_callbacks) = {
	.connected = connected,
	.disconnected = disconnected,
};

static void device_found(const bt_addr_le_t *addr, int8_t rssi, uint8_t type,
			 struct net_buf_simple *ad)
{
	char addr_str[BT_ADDR_LE_STR_LEN];
	int err;

	if (g_conn != NULL) {
		return;
	}

	/* Only interested in connectable advertising. */
	if (type != BT_HCI_ADV_IND && type != BT_HCI_ADV_DIRECT_IND) {
		return;
	}

	bt_addr_le_to_str(addr, addr_str, sizeof(addr_str));
	printk("Device found: %s (RSSI %d)\n", addr_str, rssi);

	err = bt_le_scan_stop();
	if (err != 0) {
		TEST_FAIL("Could not stop scan: %d", err);
		return;
	}

	err = bt_conn_le_create(addr, BT_CONN_LE_CREATE_CONN, BT_LE_CONN_PARAM_DEFAULT, &g_conn);
	if (err != 0) {
		TEST_FAIL("Could not connect to peer: %d", err);
	}
}

/* ------------------------------------------------------------------ */
/* Discovery                                                           */
/* ------------------------------------------------------------------ */

static struct bt_gatt_discover_params disc_params;
static uint16_t *disc_handle_out;

static uint8_t discover_func(struct bt_conn *conn, const struct bt_gatt_attr *attr,
			     struct bt_gatt_discover_params *params)
{
	ARG_UNUSED(conn);

	if (attr == NULL) {
		(void)memset(params, 0, sizeof(*params));
		SET_FLAG(flag_discover_done);
		return BT_GATT_ITER_STOP;
	}

	if (params->type == BT_GATT_DISCOVER_CHARACTERISTIC) {
		const struct bt_gatt_chrc *chrc = attr->user_data;

		*disc_handle_out = chrc->value_handle;
	}
	/* Stopping here aborts the procedure: no trailing attr == NULL
	 * callback follows, so flag completion right now.
	 */
	SET_FLAG(flag_discover_done);

	return BT_GATT_ITER_STOP;
}

static uint16_t discover_chrc(const struct bt_uuid *uuid)
{
	uint16_t handle = 0;
	int err;

	disc_handle_out = &handle;
	disc_params.uuid = uuid;
	disc_params.func = discover_func;
	disc_params.start_handle = BT_ATT_FIRST_ATTRIBUTE_HANDLE;
	disc_params.end_handle = BT_ATT_LAST_ATTRIBUTE_HANDLE;
	disc_params.type = BT_GATT_DISCOVER_CHARACTERISTIC;

	err = bt_gatt_discover(g_conn, &disc_params);
	if (err) {
		TEST_FAIL("Discover failed (err %d)", err);
	}

	WAIT_FOR_FLAG(flag_discover_done);
	UNSET_FLAG(flag_discover_done);

	return handle;
}

/* ------------------------------------------------------------------ */
/* Read and write helpers                                              */
/* ------------------------------------------------------------------ */

static struct bt_gatt_read_params read_params;
static uint8_t read_buf[512];
static uint16_t read_len;

static uint8_t read_func(struct bt_conn *conn, uint8_t err, struct bt_gatt_read_params *params,
			 const void *data, uint16_t length)
{
	ARG_UNUSED(conn);
	ARG_UNUSED(params);

	if (err) {
		TEST_FAIL("Read failed (err 0x%02x)", err);
	}

	read_len = length;
	if (data != NULL && length > 0) {
		(void)memcpy(read_buf, data, MIN(length, sizeof(read_buf)));
	}
	SET_FLAG(flag_read_done);

	return BT_GATT_ITER_STOP;
}

static uint16_t read_chrc(uint16_t handle)
{
	int err;

	read_params.func = read_func;
	read_params.handle_count = 1;
	read_params.single.handle = handle;
	read_params.single.offset = 0;

	err = bt_gatt_read(g_conn, &read_params);
	if (err) {
		TEST_FAIL("Read request failed (err %d)", err);
	}

	WAIT_FOR_FLAG(flag_read_done);
	UNSET_FLAG(flag_read_done);

	return read_len;
}

static struct bt_gatt_write_params write_params;

static void write_func(struct bt_conn *conn, uint8_t err, struct bt_gatt_write_params *params)
{
	ARG_UNUSED(conn);
	ARG_UNUSED(params);

	if (err) {
		TEST_FAIL("Write failed (err 0x%02x)", err);
	}
	SET_FLAG(flag_write_done);
}

static void write_chrc(uint16_t handle, const uint8_t *data, uint16_t len)
{
	int err;

	write_params.func = write_func;
	write_params.handle = handle;
	write_params.offset = 0;
	write_params.data = data;
	write_params.length = len;

	err = bt_gatt_write(g_conn, &write_params);
	if (err) {
		TEST_FAIL("Write request failed (err %d)", err);
	}

	WAIT_FOR_FLAG(flag_write_done);
	UNSET_FLAG(flag_write_done);
}

/* ------------------------------------------------------------------ */
/* Subscriptions                                                       */
/* ------------------------------------------------------------------ */

static volatile size_t sensor_svc_temperature_received;

static uint8_t sensor_svc_temperature_notify_cb(struct bt_conn *conn,
						struct bt_gatt_subscribe_params *params,
						const void *data, uint16_t length)
{
	ARG_UNUSED(conn);
	ARG_UNUSED(params);
	ARG_UNUSED(data);

	sensor_svc_temperature_received++;
	printk("sensor_svc/temperature: received value #%u (len %u)\n",
	       sensor_svc_temperature_received, length);

	return BT_GATT_ITER_CONTINUE;
}

static void sensor_svc_temperature_subscribed_cb(struct bt_conn *conn, uint8_t err,
						 struct bt_gatt_subscribe_params *params)
{
	ARG_UNUSED(conn);
	ARG_UNUSED(params);

	if (err) {
		TEST_FAIL("sensor_svc/temperature subscribe failed (err 0x%02x)", err);
	}

	SET_FLAG(sensor_svc_temperature_subscribed);
}

static struct bt_gatt_discover_params sensor_svc_temperature_ccc_disc;
static struct bt_gatt_subscribe_params sensor_svc_temperature_sub = {
	.notify = sensor_svc_temperature_notify_cb,
	.subscribe = sensor_svc_temperature_subscribed_cb,
	.ccc_handle = BT_GATT_AUTO_DISCOVER_CCC_HANDLE,
	.disc_params = &sensor_svc_temperature_ccc_disc,
	.end_handle = BT_ATT_LAST_ATTRIBUTE_HANDLE,
	.value = BT_GATT_CCC_NOTIFY,
};

static volatile size_t sensor_svc_humidity_received;

static uint8_t sensor_svc_humidity_notify_cb(struct bt_conn *conn,
					     struct bt_gatt_subscribe_params *params,
					     const void *data, uint16_t length)
{
	ARG_UNUSED(conn);
	ARG_UNUSED(params);
	ARG_UNUSED(data);

	sensor_svc_humidity_received++;
	printk("sensor_svc/humidity: received value #%u (len %u)\n", sensor_svc_humidity_received,
	       length);

	return BT_GATT_ITER_CONTINUE;
}

static void sensor_svc_humidity_subscribed_cb(struct bt_conn *conn, uint8_t err,
					      struct bt_gatt_subscribe_params *params)
{
	ARG_UNUSED(conn);
	ARG_UNUSED(params);

	if (err) {
		TEST_FAIL("sensor_svc/humidity subscribe failed (err 0x%02x)", err);
	}

	SET_FLAG(sensor_svc_humidity_subscribed);
}

static struct bt_gatt_discover_params sensor_svc_humidity_ccc_disc;
static struct bt_gatt_subscribe_params sensor_svc_humidity_sub = {
	.notify = sensor_svc_humidity_notify_cb,
	.subscribe = sensor_svc_humidity_subscribed_cb,
	.ccc_handle = BT_GATT_AUTO_DISCOVER_CCC_HANDLE,
	.disc_params = &sensor_svc_humidity_ccc_disc,
	.end_handle = BT_ATT_LAST_ATTRIBUTE_HANDLE,
	.value = BT_GATT_CCC_INDICATE,
};

static volatile size_t device_svc_event_flag_received;

static uint8_t device_svc_event_flag_notify_cb(struct bt_conn *conn,
					       struct bt_gatt_subscribe_params *params,
					       const void *data, uint16_t length)
{
	ARG_UNUSED(conn);
	ARG_UNUSED(params);
	ARG_UNUSED(data);

	device_svc_event_flag_received++;
	printk("device_svc/event_flag: received value #%u (len %u)\n",
	       device_svc_event_flag_received, length);

	return BT_GATT_ITER_CONTINUE;
}

static void device_svc_event_flag_subscribed_cb(struct bt_conn *conn, uint8_t err,
						struct bt_gatt_subscribe_params *params)
{
	ARG_UNUSED(conn);
	ARG_UNUSED(params);

	if (err) {
		TEST_FAIL("device_svc/event_flag subscribe failed (err 0x%02x)", err);
	}

	SET_FLAG(device_svc_event_flag_subscribed);
}

static struct bt_gatt_discover_params device_svc_event_flag_ccc_disc;
static struct bt_gatt_subscribe_params device_svc_event_flag_sub = {
	.notify = device_svc_event_flag_notify_cb,
	.subscribe = device_svc_event_flag_subscribed_cb,
	.ccc_handle = BT_GATT_AUTO_DISCOVER_CCC_HANDLE,
	.disc_params = &device_svc_event_flag_ccc_disc,
	.end_handle = BT_ATT_LAST_ATTRIBUTE_HANDLE,
	.value = BT_GATT_CCC_NOTIFY,
};

/* ------------------------------------------------------------------ */
/* Test                                                                */
/* ------------------------------------------------------------------ */

static void test_central(void)
{
	int err;

	err = bk_sync_init();
	if (err) {
		TEST_FAIL("Backchannel init failed (err %d)", err);
	}

	err = bt_enable(NULL);
	if (err != 0) {
		TEST_FAIL("Bluetooth init failed (err %d)", err);
	}

	err = bt_le_scan_start(BT_LE_SCAN_PASSIVE, device_found);
	if (err != 0) {
		TEST_FAIL("Scanning failed to start (err %d)", err);
	}

	printk("Scanning successfully started\n");

	WAIT_FOR_FLAG(flag_is_connected);

	/* Single ATT reads/writes are limited by the negotiated MTU. */
	const uint16_t att_mtu = bt_gatt_get_mtu(g_conn);

	/* Discover every generated characteristic by UUID. */
	uint16_t sensor_svc_temperature_handle = discover_chrc(SENSOR_SVC_TEMPERATURE_UUID);
	if (sensor_svc_temperature_handle == 0) {
		TEST_FAIL("sensor_svc/temperature not found");
	}
	printk("sensor_svc/temperature: value handle %u\n", sensor_svc_temperature_handle);
	uint16_t sensor_svc_humidity_handle = discover_chrc(SENSOR_SVC_HUMIDITY_UUID);
	if (sensor_svc_humidity_handle == 0) {
		TEST_FAIL("sensor_svc/humidity not found");
	}
	printk("sensor_svc/humidity: value handle %u\n", sensor_svc_humidity_handle);
	uint16_t sensor_svc_sampling_rate_handle = discover_chrc(SENSOR_SVC_SAMPLING_RATE_UUID);
	if (sensor_svc_sampling_rate_handle == 0) {
		TEST_FAIL("sensor_svc/sampling_rate not found");
	}
	printk("sensor_svc/sampling_rate: value handle %u\n", sensor_svc_sampling_rate_handle);
	uint16_t device_svc_device_name_handle = discover_chrc(DEVICE_SVC_DEVICE_NAME_UUID);
	if (device_svc_device_name_handle == 0) {
		TEST_FAIL("device_svc/device_name not found");
	}
	printk("device_svc/device_name: value handle %u\n", device_svc_device_name_handle);
	uint16_t device_svc_reboot_handle = discover_chrc(DEVICE_SVC_REBOOT_UUID);
	if (device_svc_reboot_handle == 0) {
		TEST_FAIL("device_svc/reboot not found");
	}
	printk("device_svc/reboot: value handle %u\n", device_svc_reboot_handle);
	uint16_t device_svc_event_flag_handle = discover_chrc(DEVICE_SVC_EVENT_FLAG_UUID);
	if (device_svc_event_flag_handle == 0) {
		TEST_FAIL("device_svc/event_flag not found");
	}
	printk("device_svc/event_flag: value handle %u\n", device_svc_event_flag_handle);

	/* Verify readable characteristics return the expected number of bytes.
	 * A single ATT read is capped at MTU-1, so larger values come back
	 * truncated at the first read.
	 */
	{
		uint16_t len = read_chrc(sensor_svc_temperature_handle);
		uint16_t expected = MIN(SENSOR_SVC_TEMPERATURE_SIZE, att_mtu - 1);

		if (len != expected) {
			TEST_FAIL("sensor_svc/temperature read len %u, expected %u", len, expected);
		}
	}
	{
		uint16_t len = read_chrc(sensor_svc_humidity_handle);
		uint16_t expected = MIN(SENSOR_SVC_HUMIDITY_SIZE, att_mtu - 1);

		if (len != expected) {
			TEST_FAIL("sensor_svc/humidity read len %u, expected %u", len, expected);
		}
	}
	{
		uint16_t len = read_chrc(sensor_svc_sampling_rate_handle);
		uint16_t expected = MIN(SENSOR_SVC_SAMPLING_RATE_SIZE, att_mtu - 1);

		if (len != expected) {
			TEST_FAIL("sensor_svc/sampling_rate read len %u, expected %u", len,
				  expected);
		}
	}
	{
		uint16_t len = read_chrc(device_svc_device_name_handle);
		uint16_t expected = MIN(DEVICE_SVC_DEVICE_NAME_SIZE, att_mtu - 1);

		if (len != expected) {
			TEST_FAIL("device_svc/device_name read len %u, expected %u", len, expected);
		}
	}

	/* Exercise writable characteristics; verify by read-back when possible. */
	{
		uint8_t pattern[SENSOR_SVC_SAMPLING_RATE_SIZE];
		/* An ATT write without long-write support is capped at MTU-3. */
		uint16_t wlen = MIN(sizeof(pattern), att_mtu - 3);

		for (size_t i = 0; i < sizeof(pattern); i++) {
			pattern[i] = (uint8_t)(0xa5 ^ i);
		}

		write_chrc(sensor_svc_sampling_rate_handle, pattern, wlen);
		{
			uint16_t len = read_chrc(sensor_svc_sampling_rate_handle);

			if (len < wlen || memcmp(read_buf, pattern, wlen) != 0) {
				TEST_FAIL("sensor_svc/sampling_rate read-back mismatch");
			}
		}
	}
	{
		uint8_t pattern[DEVICE_SVC_REBOOT_SIZE];
		/* An ATT write without long-write support is capped at MTU-3. */
		uint16_t wlen = MIN(sizeof(pattern), att_mtu - 3);

		for (size_t i = 0; i < sizeof(pattern); i++) {
			pattern[i] = (uint8_t)(0xa5 ^ i);
		}

		write_chrc(device_svc_reboot_handle, pattern, wlen);
	}

	/* Subscribe to every notification/indication source. */
	sensor_svc_temperature_sub.value_handle = sensor_svc_temperature_handle;
	err = bt_gatt_subscribe(g_conn, &sensor_svc_temperature_sub);
	if (err < 0) {
		TEST_FAIL("sensor_svc/temperature subscribe failed (err %d)", err);
	}
	WAIT_FOR_FLAG(sensor_svc_temperature_subscribed);
	sensor_svc_humidity_sub.value_handle = sensor_svc_humidity_handle;
	err = bt_gatt_subscribe(g_conn, &sensor_svc_humidity_sub);
	if (err < 0) {
		TEST_FAIL("sensor_svc/humidity subscribe failed (err %d)", err);
	}
	WAIT_FOR_FLAG(sensor_svc_humidity_subscribed);
	device_svc_event_flag_sub.value_handle = device_svc_event_flag_handle;
	err = bt_gatt_subscribe(g_conn, &device_svc_event_flag_sub);
	if (err < 0) {
		TEST_FAIL("device_svc/event_flag subscribe failed (err %d)", err);
	}
	WAIT_FOR_FLAG(device_svc_event_flag_subscribed);

	printk("All characteristics verified; signalling peripheral\n");

	/* Tell the peripheral to start pushing values. */
	bk_sync_send();

	/* Wait for the expected pushes. */
	for (int i = 0; i < WAIT_ITERS; i++) {
		if (sensor_svc_temperature_received >= NOTIFICATION_COUNT &&
		    sensor_svc_humidity_received >= 1 &&
		    device_svc_event_flag_received >= NOTIFICATION_COUNT) {
			break;
		}
		k_sleep(K_MSEC(10));
	}
	if (sensor_svc_temperature_received < NOTIFICATION_COUNT) {
		TEST_FAIL("sensor_svc/temperature: got %u values, expected %u",
			  sensor_svc_temperature_received, NOTIFICATION_COUNT);
	}
	if (sensor_svc_humidity_received < 1) {
		TEST_FAIL("sensor_svc/humidity: got %u values, expected %u",
			  sensor_svc_humidity_received, 1);
	}
	if (device_svc_event_flag_received < NOTIFICATION_COUNT) {
		TEST_FAIL("device_svc/event_flag: got %u values, expected %u",
			  device_svc_event_flag_received, NOTIFICATION_COUNT);
	}

	/* Verification complete; let the peripheral pass. */
	bk_sync_send();

	TEST_PASS("gatt_gen_multi central passed");
}

static const struct bst_test_instance test_central_def[] = {
	{
		.test_id = "central",
		.test_main_f = test_central,
	},
	BSTEST_END_MARKER,
};

struct bst_test_list *test_central_install(struct bst_test_list *tests)
{
	return bst_add_tests(tests, test_central_def);
}
```

## src/peripheral.c
```c
/*
 * Copyright (c) 2026 Ankit Modi
 *
 * SPDX-License-Identifier: Apache-2.0
 */

/** @file
 *  @brief BabbleSim peripheral role for the gatt_gen_multi self-test.
 *
 *  Runs the generated GATT services, advertises, and pushes notification /
 *  indication values once the central device reports it is subscribed.
 *
 *  Auto-generated by ble-gatt-generator; do not edit.
 */

#include <stddef.h>
#include <errno.h>
#include <string.h>

#include <zephyr/kernel.h>
#include <zephyr/types.h>
#include <zephyr/bluetooth/bluetooth.h>
#include <zephyr/bluetooth/conn.h>
#include <zephyr/bluetooth/uuid.h>
#include <zephyr/bluetooth/gatt.h>

#include "babblekit/testcase.h"
#include "babblekit/flags.h"
#include "babblekit/sync.h"

#include "sensor_svc_service.h"
#include "device_svc_service.h"

/* Notifications pushed per characteristic once the central subscribes. */
#define NOTIFICATION_COUNT 5

DEFINE_FLAG_STATIC(flag_is_connected);
static struct bt_conn *g_conn;

static void connected(struct bt_conn *conn, uint8_t err)
{
	char addr[BT_ADDR_LE_STR_LEN];

	bt_addr_le_to_str(bt_conn_get_dst(conn), addr, sizeof(addr));

	if (err != 0) {
		TEST_FAIL("Failed to connect to %s (%u)", addr, err);
		return;
	}

	printk("Connected to %s\n", addr);

	g_conn = bt_conn_ref(conn);
	SET_FLAG(flag_is_connected);
}

static void disconnected(struct bt_conn *conn, uint8_t reason)
{
	char addr[BT_ADDR_LE_STR_LEN];

	if (conn != g_conn) {
		return;
	}

	bt_addr_le_to_str(bt_conn_get_dst(conn), addr, sizeof(addr));

	printk("Disconnected: %s (reason 0x%02x)\n", addr, reason);

	bt_conn_unref(g_conn);
	g_conn = NULL;
	UNSET_FLAG(flag_is_connected);
}

BT_CONN_CB_DEFINE(conn_callbacks) = {
	.connected = connected,
	.disconnected = disconnected,
};

static const struct bt_data ad[] = {
	BT_DATA_BYTES(BT_DATA_FLAGS, (BT_LE_AD_GENERAL | BT_LE_AD_NO_BREDR)),
	BT_DATA_BYTES(BT_DATA_UUID128_ALL,
		      BT_UUID_128_ENCODE(0x12345678, 0x1234, 0x5678, 0x1234, 0x56789abcdef0)),
};

static void test_peripheral(void)
{
	int err;

	err = bk_sync_init();
	if (err) {
		TEST_FAIL("Backchannel init failed (err %d)", err);
	}

	err = bt_enable(NULL);
	if (err != 0) {
		TEST_FAIL("Bluetooth init failed (err %d)", err);
	}

	printk("Bluetooth initialized\n");

	err = bt_le_adv_start(BT_LE_ADV_CONN_FAST_1, ad, ARRAY_SIZE(ad), NULL, 0);
	if (err != 0) {
		TEST_FAIL("Advertising failed to start (err %d)", err);
	}

	printk("Advertising successfully started\n");

	WAIT_FOR_FLAG(flag_is_connected);

	/* Wait until the central has discovered and subscribed. */
	bk_sync_wait();
	printk("Peer ready, pushing values\n");

	for (int i = 0; i < NOTIFICATION_COUNT; i++) {
		uint8_t payload[SENSOR_SVC_TEMPERATURE_SIZE];

		(void)memset(payload, i, sizeof(payload));
		err = sensor_svc_temperature_notify(payload, sizeof(payload));
		if (err) {
			TEST_FAIL("temperature notify failed (err %d)", err);
		}
	}
	{
		uint8_t payload[SENSOR_SVC_HUMIDITY_SIZE];

		(void)memset(payload, 0x5a, sizeof(payload));
		err = sensor_svc_humidity_indicate(payload, sizeof(payload));
		if (err) {
			TEST_FAIL("humidity indicate failed (err %d)", err);
		}
		/* Let the confirmation arrive before proceeding. */
		k_sleep(K_MSEC(100));
	}
	for (int i = 0; i < NOTIFICATION_COUNT; i++) {
		uint8_t payload[DEVICE_SVC_EVENT_FLAG_SIZE];

		(void)memset(payload, i, sizeof(payload));
		err = device_svc_event_flag_notify(payload, sizeof(payload));
		if (err) {
			TEST_FAIL("event_flag notify failed (err %d)", err);
		}
	}

	/* Wait until the central has verified all values, then pass. */
	bk_sync_wait();

	TEST_PASS("gatt_gen_multi peripheral passed");
}

static const struct bst_test_instance test_peripheral_def[] = {
	{
		.test_id = "peripheral",
		.test_main_f = test_peripheral,
	},
	BSTEST_END_MARKER,
};

struct bst_test_list *test_peripheral_install(struct bst_test_list *tests)
{
	return bst_add_tests(tests, test_peripheral_def);
}
```
