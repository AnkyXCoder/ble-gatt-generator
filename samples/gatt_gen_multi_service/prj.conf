## CMakeLists.txt
```
cmake_minimum_required(VERSION 3.20.0)

find_package(Zephyr REQUIRED HINTS $ENV{ZEPHYR_BASE})
project(gatt_gen_multi)

target_sources(app PRIVATE src/main.c)
target_sources(app PRIVATE src/sensor_svc_service.c)
target_sources(app PRIVATE src/device_svc_service.c)
```

## sample.yaml
```
sample:
  name: GATT Generated gatt_gen_multi

tests:
  sample.bluetooth.ble_gatt_generator_gatt_gen_multi:
    build_only: true
    platform_allow:
      - native_sim
      - nrf52_bsim/native
    tags: bluetooth
```

## prj.conf
```kconfig
# Minimal Kconfig for the gatt_gen_multi profile.
# See KCONFIG_NOTES.md for why each symbol is required.
CONFIG_BT=y
CONFIG_BT_DEVICE_NAME="GATT Gen gatt_gen_multi"
CONFIG_BT_PERIPHERAL=y
# (advisory) CONFIG_BT_GATT_NOTIFY_MULTIPLE=y — Optional: batch notifications when several CCCs are enabled at once
CONFIG_LOG=y
CONFIG_BT_DEVICE_APPEARANCE=0
```

## src/main.c
```c
/*
 * Copyright (c) 2026 Ankit Modi
 *
 * SPDX-License-Identifier: Apache-2.0
 */

/** @file
 *  @brief Sample application for the generated gatt_gen_multi GATT profile.
 *
 *  Generated once by ble-gatt-generator. This file is yours to edit; it is
 *  not overwritten on regeneration unless --force is given.
 */

#include <zephyr/bluetooth/bluetooth.h>
#include <zephyr/bluetooth/conn.h>
#include <zephyr/bluetooth/gatt.h>
#include <zephyr/bluetooth/uuid.h>
#include <zephyr/kernel.h>
#include <zephyr/sys/printk.h>

#include "sensor_svc_service.h"
#include "device_svc_service.h"

/* Advertise the first service UUID so scanners can filter on it. */
static const struct bt_data ad[] = {
	BT_DATA_BYTES(BT_DATA_FLAGS, (BT_LE_AD_GENERAL | BT_LE_AD_NO_BREDR)),
	BT_DATA_BYTES(BT_DATA_UUID128_ALL,
		      BT_UUID_128_ENCODE(0x12345678, 0x1234, 0x5678, 0x1234, 0x56789abcdef0)),
};

static const struct bt_data sd[] = {
	BT_DATA(BT_DATA_NAME_COMPLETE, CONFIG_BT_DEVICE_NAME, sizeof(CONFIG_BT_DEVICE_NAME) - 1),
};

int main(void)
{
	int err;

	err = bt_enable(NULL);
	if (err) {
		printk("Bluetooth init failed (err %d)\n", err);
		return 0;
	}

	printk("Bluetooth initialized\n");

	err = bt_le_adv_start(BT_LE_ADV_CONN_FAST_1, ad, ARRAY_SIZE(ad), sd, ARRAY_SIZE(sd));
	if (err) {
		printk("Advertising failed to start (err %d)\n", err);
		return 0;
	}

	printk("Advertising successfully started\n");

	while (1) {
		k_sleep(K_SECONDS(1));
	}

	return 0;
}
```

## src/device_svc_service.c
```c
/*
 * Copyright (c) 2026 Ankit Modi
 *
 * SPDX-License-Identifier: Apache-2.0
 */

/** @file
 *  @brief gatt_gen_multi GATT service implementation (device_svc).
 *
 *  Auto-generated by ble-gatt-generator; do not edit. Put application logic in
 *  main.c or your own sources and call the public helpers declared in
 *  device_svc_service.h.
 */

#include <errno.h>
#include <stdint.h>
#include <string.h>

#include <zephyr/kernel.h>
#include <zephyr/sys/printk.h>
#include <zephyr/bluetooth/bluetooth.h>
#include <zephyr/bluetooth/gatt.h>
#include <zephyr/bluetooth/uuid.h>

#include "device_svc_service.h"

/* ------------------------------------------------------------------------- */
/* Characteristic value storage                                              */
/* ------------------------------------------------------------------------- */

static uint8_t device_svc_device_name_value[DEVICE_SVC_DEVICE_NAME_SIZE];
static K_MUTEX_DEFINE(device_svc_device_name_lock);
static uint8_t device_svc_reboot_value[DEVICE_SVC_REBOOT_SIZE];
static K_MUTEX_DEFINE(device_svc_reboot_lock);
static uint8_t device_svc_event_flag_value[DEVICE_SVC_EVENT_FLAG_SIZE];
static K_MUTEX_DEFINE(device_svc_event_flag_lock);

/* ------------------------------------------------------------------------- */
/* Static descriptor payloads                                                */
/* ------------------------------------------------------------------------- */

/* ------------------------------------------------------------------------- */
/* Thread-safe accessors                                                     */
/* ------------------------------------------------------------------------- */

int device_svc_device_name_set(const uint8_t *data, uint16_t len)
{
	if (data == NULL || len > sizeof(device_svc_device_name_value)) {
		return -EINVAL;
	}

	k_mutex_lock(&device_svc_device_name_lock, K_FOREVER);
	memcpy(device_svc_device_name_value, data, len);
	k_mutex_unlock(&device_svc_device_name_lock);

	return 0;
}

int device_svc_device_name_get(uint8_t *data, uint16_t len)
{
	if (data == NULL) {
		return -EINVAL;
	}
	if (len > sizeof(device_svc_device_name_value)) {
		return -EINVAL;
	}

	k_mutex_lock(&device_svc_device_name_lock, K_FOREVER);
	memcpy(data, device_svc_device_name_value, MIN(len, sizeof(device_svc_device_name_value)));
	k_mutex_unlock(&device_svc_device_name_lock);

	return 0;
}

int device_svc_reboot_set(const uint8_t *data, uint16_t len)
{
	if (data == NULL || len > sizeof(device_svc_reboot_value)) {
		return -EINVAL;
	}

	k_mutex_lock(&device_svc_reboot_lock, K_FOREVER);
	memcpy(device_svc_reboot_value, data, len);
	k_mutex_unlock(&device_svc_reboot_lock);

	return 0;
}

int device_svc_reboot_get(uint8_t *data, uint16_t len)
{
	if (data == NULL) {
		return -EINVAL;
	}
	if (len > sizeof(device_svc_reboot_value)) {
		return -EINVAL;
	}

	k_mutex_lock(&device_svc_reboot_lock, K_FOREVER);
	memcpy(data, device_svc_reboot_value, MIN(len, sizeof(device_svc_reboot_value)));
	k_mutex_unlock(&device_svc_reboot_lock);

	return 0;
}

int device_svc_event_flag_set(const uint8_t *data, uint16_t len)
{
	if (data == NULL || len > sizeof(device_svc_event_flag_value)) {
		return -EINVAL;
	}

	k_mutex_lock(&device_svc_event_flag_lock, K_FOREVER);
	memcpy(device_svc_event_flag_value, data, len);
	k_mutex_unlock(&device_svc_event_flag_lock);

	return 0;
}

int device_svc_event_flag_get(uint8_t *data, uint16_t len)
{
	if (data == NULL) {
		return -EINVAL;
	}
	if (len > sizeof(device_svc_event_flag_value)) {
		return -EINVAL;
	}

	k_mutex_lock(&device_svc_event_flag_lock, K_FOREVER);
	memcpy(data, device_svc_event_flag_value, MIN(len, sizeof(device_svc_event_flag_value)));
	k_mutex_unlock(&device_svc_event_flag_lock);

	return 0;
}

/* ------------------------------------------------------------------------- */
/* GATT attribute callbacks                                                  */
/* ------------------------------------------------------------------------- */

static ssize_t device_svc_device_name_read(struct bt_conn *conn, const struct bt_gatt_attr *attr,
					   void *buf, uint16_t len, uint16_t offset)
{
	ssize_t ret;

	device_svc_device_name_on_read();

	k_mutex_lock(&device_svc_device_name_lock, K_FOREVER);
	ret = bt_gatt_attr_read(conn, attr, buf, len, offset, device_svc_device_name_value,
				sizeof(device_svc_device_name_value));
	k_mutex_unlock(&device_svc_device_name_lock);

	return ret;
}

static ssize_t device_svc_reboot_write(struct bt_conn *conn, const struct bt_gatt_attr *attr,
				       const void *buf, uint16_t len, uint16_t offset,
				       uint8_t flags)
{
	ARG_UNUSED(conn);
	ARG_UNUSED(attr);

	if (offset + len > sizeof(device_svc_reboot_value)) {
		return BT_GATT_ERR(BT_ATT_ERR_INVALID_OFFSET);
	}

	/* Prepare writes only validate; the value is committed on execute. */
	if (flags & BT_GATT_WRITE_FLAG_PREPARE) {
		return 0;
	}

	k_mutex_lock(&device_svc_reboot_lock, K_FOREVER);
	memcpy(device_svc_reboot_value + offset, buf, len);
	k_mutex_unlock(&device_svc_reboot_lock);

	device_svc_reboot_on_write(device_svc_reboot_value, sizeof(device_svc_reboot_value));

	return len;
}

static void device_svc_event_flag_ccc_cfg_changed(const struct bt_gatt_attr *attr, uint16_t value)
{
	bool enabled = value == BT_GATT_CCC_NOTIFY;

	ARG_UNUSED(attr);

	printk("event_flag notifications %s\n", enabled ? "enabled" : "disabled");

	device_svc_event_flag_on_ccc(enabled);
}

/* ------------------------------------------------------------------------- */
/* Application hooks (weak defaults; override in your own sources)           */
/* ------------------------------------------------------------------------- */

__weak void device_svc_device_name_on_read(void)
{
}

__weak void device_svc_reboot_on_write(const uint8_t *data, uint16_t len)
{
	ARG_UNUSED(data);
	ARG_UNUSED(len);
}

__weak void device_svc_event_flag_on_ccc(bool enabled)
{
	ARG_UNUSED(enabled);
}

/* ------------------------------------------------------------------------- */
/* Push helpers                                                              */
/* ------------------------------------------------------------------------- */

int device_svc_event_flag_notify(const uint8_t *data, uint16_t len)
{
	int err;

	err = device_svc_event_flag_set(data, len);
	if (err) {
		return err;
	}

	return bt_gatt_notify_uuid(NULL, DEVICE_SVC_EVENT_FLAG_UUID, NULL,
				   device_svc_event_flag_value, len);
}

/* ------------------------------------------------------------------------- */
/* Service declaration                                                       */
/* ------------------------------------------------------------------------- */

/* clang-format off */
BT_GATT_SERVICE_DEFINE(device_svc,
	BT_GATT_PRIMARY_SERVICE(DEVICE_SVC_UUID),

	/* device_name: read */
	BT_GATT_CHARACTERISTIC(DEVICE_SVC_DEVICE_NAME_UUID,
			       BT_GATT_CHRC_READ,
			       BT_GATT_PERM_READ,
			       device_svc_device_name_read,
			       NULL,
			       device_svc_device_name_value),
	BT_GATT_CUD("Device name", BT_GATT_PERM_READ),

	/* reboot: write */
	BT_GATT_CHARACTERISTIC(DEVICE_SVC_REBOOT_UUID,
			       BT_GATT_CHRC_WRITE,
			       BT_GATT_PERM_WRITE,
			       NULL,
			       device_svc_reboot_write,
			       device_svc_reboot_value),

	/* event_flag: notify */
	BT_GATT_CHARACTERISTIC(DEVICE_SVC_EVENT_FLAG_UUID,
			       BT_GATT_CHRC_NOTIFY,
			       BT_GATT_PERM_NONE,
			       NULL,
			       NULL,
			       device_svc_event_flag_value),
	BT_GATT_CCC(device_svc_event_flag_ccc_cfg_changed, BT_GATT_PERM_READ | BT_GATT_PERM_WRITE),
);
/* clang-format on */
```

## src/device_svc_service.h
```c
/*
 * Copyright (c) 2026 Ankit Modi
 *
 * SPDX-License-Identifier: Apache-2.0
 */

/** @file
 *  @brief gatt_gen_multi GATT service public API (device_svc).
 *
 *  Auto-generated by ble-gatt-generator; do not edit.
 */

#ifndef BLE_GATT_GENERATOR_DEVICE_SVC_H_
#define BLE_GATT_GENERATOR_DEVICE_SVC_H_

#include <stdbool.h>
#include <stdint.h>

#include <zephyr/bluetooth/uuid.h>

#ifdef __cplusplus
extern "C" {
#endif

/** @defgroup device_svc device_svc service
 *  @brief Generated helpers for the device_svc GATT service.
 *  @{
 */

/* Service and characteristic UUIDs. */
#define DEVICE_SVC_UUID                                                                            \
	BT_UUID_DECLARE_128(BT_UUID_128_ENCODE(0x12345678, 0x1234, 0x5678, 0x1234, 0x56789abcde10))
#define DEVICE_SVC_DEVICE_NAME_UUID                                                                \
	BT_UUID_DECLARE_128(BT_UUID_128_ENCODE(0x12345678, 0x1234, 0x5678, 0x1234, 0x56789abcde11))
#define DEVICE_SVC_REBOOT_UUID                                                                     \
	BT_UUID_DECLARE_128(BT_UUID_128_ENCODE(0x12345678, 0x1234, 0x5678, 0x1234, 0x56789abcde12))
#define DEVICE_SVC_EVENT_FLAG_UUID                                                                 \
	BT_UUID_DECLARE_128(BT_UUID_128_ENCODE(0x12345678, 0x1234, 0x5678, 0x1234, 0x56789abcde13))

/* Characteristic value sizes in bytes. */
#define DEVICE_SVC_DEVICE_NAME_SIZE 20
#define DEVICE_SVC_REBOOT_SIZE      1
#define DEVICE_SVC_EVENT_FLAG_SIZE  4

/** @brief Set the device_name characteristic value.
 *
 *  Thread-safe when @c thread_safe is enabled for this characteristic.
 *
 *  @param data Pointer to the data to copy into the value buffer.
 *  @param len  Number of bytes to copy; must not exceed
 *              DEVICE_SVC_DEVICE_NAME_SIZE.
 *
 *  @retval 0 on success.
 *  @retval -EINVAL if @p data is NULL or @p len is too large.
 */
int device_svc_device_name_set(const uint8_t *data, uint16_t len);

/** @brief Get the device_name characteristic value.
 *
 *  @param data Buffer to receive the value.
 *  @param len  Number of bytes to copy; must not exceed
 *              DEVICE_SVC_DEVICE_NAME_SIZE.
 *
 *  @retval 0 on success.
 *  @retval -EINVAL if @p data is NULL or @p len is too large.
 */
int device_svc_device_name_get(uint8_t *data, uint16_t len);

/** @brief Application hook called before a peer reads device_name.
 *
 *  Defined as a weak no-op in the generated source. Define it in your own
 *  code to refresh the value or gate the read; it runs from the Bluetooth
 *  RX context, so keep it short.
 */
void device_svc_device_name_on_read(void);

/** @brief Set the reboot characteristic value.
 *
 *  Thread-safe when @c thread_safe is enabled for this characteristic.
 *
 *  @param data Pointer to the data to copy into the value buffer.
 *  @param len  Number of bytes to copy; must not exceed
 *              DEVICE_SVC_REBOOT_SIZE.
 *
 *  @retval 0 on success.
 *  @retval -EINVAL if @p data is NULL or @p len is too large.
 */
int device_svc_reboot_set(const uint8_t *data, uint16_t len);

/** @brief Get the reboot characteristic value.
 *
 *  @param data Buffer to receive the value.
 *  @param len  Number of bytes to copy; must not exceed
 *              DEVICE_SVC_REBOOT_SIZE.
 *
 *  @retval 0 on success.
 *  @retval -EINVAL if @p data is NULL or @p len is too large.
 */
int device_svc_reboot_get(uint8_t *data, uint16_t len);

/** @brief Application hook called after a peer writes reboot.
 *
 *  Defined as a weak no-op in the generated source. Define this function in
 *  your own code to react to remote writes; it is called outside the value
 *  lock from the Bluetooth RX context, so keep it short.
 *
 *  @param data Pointer to the (already updated) value buffer.
 *  @param len  Size of the value buffer in bytes.
 */
void device_svc_reboot_on_write(const uint8_t *data, uint16_t len);

/** @brief Set the event_flag characteristic value.
 *
 *  Thread-safe when @c thread_safe is enabled for this characteristic.
 *
 *  @param data Pointer to the data to copy into the value buffer.
 *  @param len  Number of bytes to copy; must not exceed
 *              DEVICE_SVC_EVENT_FLAG_SIZE.
 *
 *  @retval 0 on success.
 *  @retval -EINVAL if @p data is NULL or @p len is too large.
 */
int device_svc_event_flag_set(const uint8_t *data, uint16_t len);

/** @brief Get the event_flag characteristic value.
 *
 *  @param data Buffer to receive the value.
 *  @param len  Number of bytes to copy; must not exceed
 *              DEVICE_SVC_EVENT_FLAG_SIZE.
 *
 *  @retval 0 on success.
 *  @retval -EINVAL if @p data is NULL or @p len is too large.
 */
int device_svc_event_flag_get(uint8_t *data, uint16_t len);

/** @brief Update and notify the event_flag characteristic.
 *
 *  @param data Pointer to the new value.
 *  @param len  Length of the data in bytes.
 *
 *  @return 0 on success, or a negative error code (see bt_gatt_notify_uuid()).
 */
int device_svc_event_flag_notify(const uint8_t *data, uint16_t len);

/** @brief Application hook called when event_flag CCC state changes.
 *
 *  Defined as a weak no-op in the generated source. Define it in your own
 *  code to react to a peer enabling/disabling
 *  notifications.
 *
 *  @param enabled True when notifications were enabled.
 */
void device_svc_event_flag_on_ccc(bool enabled);

/** @} */

#ifdef __cplusplus
}
#endif

#endif /* BLE_GATT_GENERATOR_DEVICE_SVC_H_ */
```

## src/sensor_svc_service.c
```c
/*
 * Copyright (c) 2026 Ankit Modi
 *
 * SPDX-License-Identifier: Apache-2.0
 */

/** @file
 *  @brief gatt_gen_multi GATT service implementation (sensor_svc).
 *
 *  Auto-generated by ble-gatt-generator; do not edit. Put application logic in
 *  main.c or your own sources and call the public helpers declared in
 *  sensor_svc_service.h.
 */

#include <errno.h>
#include <stdint.h>
#include <string.h>

#include <zephyr/kernel.h>
#include <zephyr/sys/printk.h>
#include <zephyr/bluetooth/bluetooth.h>
#include <zephyr/bluetooth/gatt.h>
#include <zephyr/bluetooth/uuid.h>

#include "sensor_svc_service.h"

/* ------------------------------------------------------------------------- */
/* Characteristic value storage                                              */
/* ------------------------------------------------------------------------- */

static uint8_t sensor_svc_temperature_value[SENSOR_SVC_TEMPERATURE_SIZE];
static K_MUTEX_DEFINE(sensor_svc_temperature_lock);
static uint8_t sensor_svc_humidity_value[SENSOR_SVC_HUMIDITY_SIZE];
static K_MUTEX_DEFINE(sensor_svc_humidity_lock);
static uint8_t sensor_svc_sampling_rate_value[SENSOR_SVC_SAMPLING_RATE_SIZE];
static K_MUTEX_DEFINE(sensor_svc_sampling_rate_lock);

/* ------------------------------------------------------------------------- */
/* Static descriptor payloads                                                */
/* ------------------------------------------------------------------------- */

static const struct bt_gatt_cpf sensor_svc_temperature_cpf = {
	.format = 14,
	.exponent = -2,
	.unit = 10031,
	.name_space = 1,
	.description = 0,
};

/* ------------------------------------------------------------------------- */
/* Thread-safe accessors                                                     */
/* ------------------------------------------------------------------------- */

int sensor_svc_temperature_set(const uint8_t *data, uint16_t len)
{
	if (data == NULL || len > sizeof(sensor_svc_temperature_value)) {
		return -EINVAL;
	}

	k_mutex_lock(&sensor_svc_temperature_lock, K_FOREVER);
	memcpy(sensor_svc_temperature_value, data, len);
	k_mutex_unlock(&sensor_svc_temperature_lock);

	return 0;
}

int sensor_svc_temperature_get(uint8_t *data, uint16_t len)
{
	if (data == NULL) {
		return -EINVAL;
	}
	if (len > sizeof(sensor_svc_temperature_value)) {
		return -EINVAL;
	}

	k_mutex_lock(&sensor_svc_temperature_lock, K_FOREVER);
	memcpy(data, sensor_svc_temperature_value, MIN(len, sizeof(sensor_svc_temperature_value)));
	k_mutex_unlock(&sensor_svc_temperature_lock);

	return 0;
}

int sensor_svc_humidity_set(const uint8_t *data, uint16_t len)
{
	if (data == NULL || len > sizeof(sensor_svc_humidity_value)) {
		return -EINVAL;
	}

	k_mutex_lock(&sensor_svc_humidity_lock, K_FOREVER);
	memcpy(sensor_svc_humidity_value, data, len);
	k_mutex_unlock(&sensor_svc_humidity_lock);

	return 0;
}

int sensor_svc_humidity_get(uint8_t *data, uint16_t len)
{
	if (data == NULL) {
		return -EINVAL;
	}
	if (len > sizeof(sensor_svc_humidity_value)) {
		return -EINVAL;
	}

	k_mutex_lock(&sensor_svc_humidity_lock, K_FOREVER);
	memcpy(data, sensor_svc_humidity_value, MIN(len, sizeof(sensor_svc_humidity_value)));
	k_mutex_unlock(&sensor_svc_humidity_lock);

	return 0;
}

int sensor_svc_sampling_rate_set(const uint8_t *data, uint16_t len)
{
	if (data == NULL || len > sizeof(sensor_svc_sampling_rate_value)) {
		return -EINVAL;
	}

	k_mutex_lock(&sensor_svc_sampling_rate_lock, K_FOREVER);
	memcpy(sensor_svc_sampling_rate_value, data, len);
	k_mutex_unlock(&sensor_svc_sampling_rate_lock);

	return 0;
}

int sensor_svc_sampling_rate_get(uint8_t *data, uint16_t len)
{
	if (data == NULL) {
		return -EINVAL;
	}
	if (len > sizeof(sensor_svc_sampling_rate_value)) {
		return -EINVAL;
	}

	k_mutex_lock(&sensor_svc_sampling_rate_lock, K_FOREVER);
	memcpy(data, sensor_svc_sampling_rate_value,
	       MIN(len, sizeof(sensor_svc_sampling_rate_value)));
	k_mutex_unlock(&sensor_svc_sampling_rate_lock);

	return 0;
}

/* ------------------------------------------------------------------------- */
/* GATT attribute callbacks                                                  */
/* ------------------------------------------------------------------------- */

static ssize_t sensor_svc_temperature_read(struct bt_conn *conn, const struct bt_gatt_attr *attr,
					   void *buf, uint16_t len, uint16_t offset)
{
	ssize_t ret;

	sensor_svc_temperature_on_read();

	k_mutex_lock(&sensor_svc_temperature_lock, K_FOREVER);
	ret = bt_gatt_attr_read(conn, attr, buf, len, offset, sensor_svc_temperature_value,
				sizeof(sensor_svc_temperature_value));
	k_mutex_unlock(&sensor_svc_temperature_lock);

	return ret;
}

static void sensor_svc_temperature_ccc_cfg_changed(const struct bt_gatt_attr *attr, uint16_t value)
{
	bool enabled = value == BT_GATT_CCC_NOTIFY;

	ARG_UNUSED(attr);

	printk("temperature notifications %s\n", enabled ? "enabled" : "disabled");

	sensor_svc_temperature_on_ccc(enabled);
}

static ssize_t sensor_svc_humidity_read(struct bt_conn *conn, const struct bt_gatt_attr *attr,
					void *buf, uint16_t len, uint16_t offset)
{
	ssize_t ret;

	sensor_svc_humidity_on_read();

	k_mutex_lock(&sensor_svc_humidity_lock, K_FOREVER);
	ret = bt_gatt_attr_read(conn, attr, buf, len, offset, sensor_svc_humidity_value,
				sizeof(sensor_svc_humidity_value));
	k_mutex_unlock(&sensor_svc_humidity_lock);

	return ret;
}

static void sensor_svc_humidity_ccc_cfg_changed(const struct bt_gatt_attr *attr, uint16_t value)
{
	bool enabled = value == BT_GATT_CCC_INDICATE;

	ARG_UNUSED(attr);

	printk("humidity indications %s\n", enabled ? "enabled" : "disabled");

	sensor_svc_humidity_on_ccc(enabled);
}

static ssize_t sensor_svc_sampling_rate_read(struct bt_conn *conn, const struct bt_gatt_attr *attr,
					     void *buf, uint16_t len, uint16_t offset)
{
	ssize_t ret;

	sensor_svc_sampling_rate_on_read();

	k_mutex_lock(&sensor_svc_sampling_rate_lock, K_FOREVER);
	ret = bt_gatt_attr_read(conn, attr, buf, len, offset, sensor_svc_sampling_rate_value,
				sizeof(sensor_svc_sampling_rate_value));
	k_mutex_unlock(&sensor_svc_sampling_rate_lock);

	return ret;
}

static ssize_t sensor_svc_sampling_rate_write(struct bt_conn *conn, const struct bt_gatt_attr *attr,
					      const void *buf, uint16_t len, uint16_t offset,
					      uint8_t flags)
{
	ARG_UNUSED(conn);
	ARG_UNUSED(attr);

	if (offset + len > sizeof(sensor_svc_sampling_rate_value)) {
		return BT_GATT_ERR(BT_ATT_ERR_INVALID_OFFSET);
	}

	/* Prepare writes only validate; the value is committed on execute. */
	if (flags & BT_GATT_WRITE_FLAG_PREPARE) {
		return 0;
	}

	k_mutex_lock(&sensor_svc_sampling_rate_lock, K_FOREVER);
	memcpy(sensor_svc_sampling_rate_value + offset, buf, len);
	k_mutex_unlock(&sensor_svc_sampling_rate_lock);

	sensor_svc_sampling_rate_on_write(sensor_svc_sampling_rate_value,
					  sizeof(sensor_svc_sampling_rate_value));

	return len;
}

/* ------------------------------------------------------------------------- */
/* Application hooks (weak defaults; override in your own sources)           */
/* ------------------------------------------------------------------------- */

__weak void sensor_svc_temperature_on_read(void)
{
}
__weak void sensor_svc_temperature_on_ccc(bool enabled)
{
	ARG_UNUSED(enabled);
}

__weak void sensor_svc_humidity_on_read(void)
{
}
__weak void sensor_svc_humidity_on_ccc(bool enabled)
{
	ARG_UNUSED(enabled);
}

__weak void sensor_svc_sampling_rate_on_read(void)
{
}
__weak void sensor_svc_sampling_rate_on_write(const uint8_t *data, uint16_t len)
{
	ARG_UNUSED(data);
	ARG_UNUSED(len);
}

/* ------------------------------------------------------------------------- */
/* Push helpers                                                              */
/* ------------------------------------------------------------------------- */

int sensor_svc_temperature_notify(const uint8_t *data, uint16_t len)
{
	int err;

	err = sensor_svc_temperature_set(data, len);
	if (err) {
		return err;
	}

	return bt_gatt_notify_uuid(NULL, SENSOR_SVC_TEMPERATURE_UUID, NULL,
				   sensor_svc_temperature_value, len);
}

static struct bt_gatt_indicate_params sensor_svc_humidity_ind_params;

int sensor_svc_humidity_indicate(const uint8_t *data, uint16_t len)
{
	int err;

	err = sensor_svc_humidity_set(data, len);
	if (err) {
		return err;
	}

	sensor_svc_humidity_ind_params.uuid = SENSOR_SVC_HUMIDITY_UUID;
	sensor_svc_humidity_ind_params.attr = NULL;
	sensor_svc_humidity_ind_params.data = sensor_svc_humidity_value;
	sensor_svc_humidity_ind_params.len = len;

	return bt_gatt_indicate(NULL, &sensor_svc_humidity_ind_params);
}

/* ------------------------------------------------------------------------- */
/* Service declaration                                                       */
/* ------------------------------------------------------------------------- */

/* clang-format off */
BT_GATT_SERVICE_DEFINE(sensor_svc,
	BT_GATT_PRIMARY_SERVICE(SENSOR_SVC_UUID),

	/* temperature: read, notify */
	BT_GATT_CHARACTERISTIC(SENSOR_SVC_TEMPERATURE_UUID,
			       BT_GATT_CHRC_READ | BT_GATT_CHRC_NOTIFY,
			       BT_GATT_PERM_READ,
			       sensor_svc_temperature_read,
			       NULL,
			       sensor_svc_temperature_value),
	BT_GATT_CUD("Temperature, 0.01 degC", BT_GATT_PERM_READ),
	BT_GATT_CPF(&sensor_svc_temperature_cpf),
	BT_GATT_CCC(sensor_svc_temperature_ccc_cfg_changed, BT_GATT_PERM_READ | BT_GATT_PERM_WRITE),

	/* humidity: read, indicate */
	BT_GATT_CHARACTERISTIC(SENSOR_SVC_HUMIDITY_UUID,
			       BT_GATT_CHRC_READ | BT_GATT_CHRC_INDICATE,
			       BT_GATT_PERM_READ,
			       sensor_svc_humidity_read,
			       NULL,
			       sensor_svc_humidity_value),
	BT_GATT_CCC(sensor_svc_humidity_ccc_cfg_changed, BT_GATT_PERM_READ | BT_GATT_PERM_WRITE),

	/* sampling_rate: read, write */
	BT_GATT_CHARACTERISTIC(SENSOR_SVC_SAMPLING_RATE_UUID,
			       BT_GATT_CHRC_READ | BT_GATT_CHRC_WRITE,
			       BT_GATT_PERM_READ | BT_GATT_PERM_WRITE,
			       sensor_svc_sampling_rate_read,
			       sensor_svc_sampling_rate_write,
			       sensor_svc_sampling_rate_value),
);
/* clang-format on */
```

## src/sensor_svc_service.h
```c
/*
 * Copyright (c) 2026 Ankit Modi
 *
 * SPDX-License-Identifier: Apache-2.0
 */

/** @file
 *  @brief gatt_gen_multi GATT service public API (sensor_svc).
 *
 *  Auto-generated by ble-gatt-generator; do not edit.
 */

#ifndef BLE_GATT_GENERATOR_SENSOR_SVC_H_
#define BLE_GATT_GENERATOR_SENSOR_SVC_H_

#include <stdbool.h>
#include <stdint.h>

#include <zephyr/bluetooth/uuid.h>

#ifdef __cplusplus
extern "C" {
#endif

/** @defgroup sensor_svc sensor_svc service
 *  @brief Generated helpers for the sensor_svc GATT service.
 *  @{
 */

/* Service and characteristic UUIDs. */
#define SENSOR_SVC_UUID                                                                            \
	BT_UUID_DECLARE_128(BT_UUID_128_ENCODE(0x12345678, 0x1234, 0x5678, 0x1234, 0x56789abcdef0))
#define SENSOR_SVC_TEMPERATURE_UUID                                                                \
	BT_UUID_DECLARE_128(BT_UUID_128_ENCODE(0x12345678, 0x1234, 0x5678, 0x1234, 0x56789abcdef1))
#define SENSOR_SVC_HUMIDITY_UUID                                                                   \
	BT_UUID_DECLARE_128(BT_UUID_128_ENCODE(0x12345678, 0x1234, 0x5678, 0x1234, 0x56789abcdef2))
#define SENSOR_SVC_SAMPLING_RATE_UUID                                                              \
	BT_UUID_DECLARE_128(BT_UUID_128_ENCODE(0x12345678, 0x1234, 0x5678, 0x1234, 0x56789abcdef3))

/* Characteristic value sizes in bytes. */
#define SENSOR_SVC_TEMPERATURE_SIZE   4
#define SENSOR_SVC_HUMIDITY_SIZE      2
#define SENSOR_SVC_SAMPLING_RATE_SIZE 2

/** @brief Set the temperature characteristic value.
 *
 *  Thread-safe when @c thread_safe is enabled for this characteristic.
 *
 *  @param data Pointer to the data to copy into the value buffer.
 *  @param len  Number of bytes to copy; must not exceed
 *              SENSOR_SVC_TEMPERATURE_SIZE.
 *
 *  @retval 0 on success.
 *  @retval -EINVAL if @p data is NULL or @p len is too large.
 */
int sensor_svc_temperature_set(const uint8_t *data, uint16_t len);

/** @brief Get the temperature characteristic value.
 *
 *  @param data Buffer to receive the value.
 *  @param len  Number of bytes to copy; must not exceed
 *              SENSOR_SVC_TEMPERATURE_SIZE.
 *
 *  @retval 0 on success.
 *  @retval -EINVAL if @p data is NULL or @p len is too large.
 */
int sensor_svc_temperature_get(uint8_t *data, uint16_t len);

/** @brief Application hook called before a peer reads temperature.
 *
 *  Defined as a weak no-op in the generated source. Define it in your own
 *  code to refresh the value or gate the read; it runs from the Bluetooth
 *  RX context, so keep it short.
 */
void sensor_svc_temperature_on_read(void);

/** @brief Update and notify the temperature characteristic.
 *
 *  @param data Pointer to the new value.
 *  @param len  Length of the data in bytes.
 *
 *  @return 0 on success, or a negative error code (see bt_gatt_notify_uuid()).
 */
int sensor_svc_temperature_notify(const uint8_t *data, uint16_t len);

/** @brief Application hook called when temperature CCC state changes.
 *
 *  Defined as a weak no-op in the generated source. Define it in your own
 *  code to react to a peer enabling/disabling
 *  notifications.
 *
 *  @param enabled True when notifications were enabled.
 */
void sensor_svc_temperature_on_ccc(bool enabled);

/** @brief Set the humidity characteristic value.
 *
 *  Thread-safe when @c thread_safe is enabled for this characteristic.
 *
 *  @param data Pointer to the data to copy into the value buffer.
 *  @param len  Number of bytes to copy; must not exceed
 *              SENSOR_SVC_HUMIDITY_SIZE.
 *
 *  @retval 0 on success.
 *  @retval -EINVAL if @p data is NULL or @p len is too large.
 */
int sensor_svc_humidity_set(const uint8_t *data, uint16_t len);

/** @brief Get the humidity characteristic value.
 *
 *  @param data Buffer to receive the value.
 *  @param len  Number of bytes to copy; must not exceed
 *              SENSOR_SVC_HUMIDITY_SIZE.
 *
 *  @retval 0 on success.
 *  @retval -EINVAL if @p data is NULL or @p len is too large.
 */
int sensor_svc_humidity_get(uint8_t *data, uint16_t len);

/** @brief Application hook called before a peer reads humidity.
 *
 *  Defined as a weak no-op in the generated source. Define it in your own
 *  code to refresh the value or gate the read; it runs from the Bluetooth
 *  RX context, so keep it short.
 */
void sensor_svc_humidity_on_read(void);

/** @brief Update and indicate the humidity characteristic.
 *
 *  @param data Pointer to the new value.
 *  @param len  Length of the data in bytes.
 *
 *  @return 0 on success, or a negative error code (see bt_gatt_indicate()).
 */
int sensor_svc_humidity_indicate(const uint8_t *data, uint16_t len);

/** @brief Application hook called when humidity CCC state changes.
 *
 *  Defined as a weak no-op in the generated source. Define it in your own
 *  code to react to a peer enabling/disabling
 *  indications.
 *
 *  @param enabled True when indications were enabled.
 */
void sensor_svc_humidity_on_ccc(bool enabled);

/** @brief Set the sampling_rate characteristic value.
 *
 *  Thread-safe when @c thread_safe is enabled for this characteristic.
 *
 *  @param data Pointer to the data to copy into the value buffer.
 *  @param len  Number of bytes to copy; must not exceed
 *              SENSOR_SVC_SAMPLING_RATE_SIZE.
 *
 *  @retval 0 on success.
 *  @retval -EINVAL if @p data is NULL or @p len is too large.
 */
int sensor_svc_sampling_rate_set(const uint8_t *data, uint16_t len);

/** @brief Get the sampling_rate characteristic value.
 *
 *  @param data Buffer to receive the value.
 *  @param len  Number of bytes to copy; must not exceed
 *              SENSOR_SVC_SAMPLING_RATE_SIZE.
 *
 *  @retval 0 on success.
 *  @retval -EINVAL if @p data is NULL or @p len is too large.
 */
int sensor_svc_sampling_rate_get(uint8_t *data, uint16_t len);

/** @brief Application hook called before a peer reads sampling_rate.
 *
 *  Defined as a weak no-op in the generated source. Define it in your own
 *  code to refresh the value or gate the read; it runs from the Bluetooth
 *  RX context, so keep it short.
 */
void sensor_svc_sampling_rate_on_read(void);

/** @brief Application hook called after a peer writes sampling_rate.
 *
 *  Defined as a weak no-op in the generated source. Define this function in
 *  your own code to react to remote writes; it is called outside the value
 *  lock from the Bluetooth RX context, so keep it short.
 *
 *  @param data Pointer to the (already updated) value buffer.
 *  @param len  Size of the value buffer in bytes.
 */
void sensor_svc_sampling_rate_on_write(const uint8_t *data, uint16_t len);

/** @} */

#ifdef __cplusplus
}
#endif

#endif /* BLE_GATT_GENERATOR_SENSOR_SVC_H_ */
```
